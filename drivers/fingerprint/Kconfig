## drivers/fingerprint/Kconfig
```kconfig
menu "BBK FINGERPRINT support"
config BBK_FINGERPRINT
	tristate "BBK FINGERPRINT support"
	help
	  Say Y here to enable switch class support. This allows
	  monitoring switches by userspace via sysfs and uevent.

if BBK_FINGERPRINT
  
config BBK_FP_ID
	tristate "BBK FP ID support"
	help
	  Say Y here to enable switch class support.
endif

source "drivers/fingerprint/gf3208/Kconfig"
source "drivers/fingerprint/gf5288/Kconfig"
source "drivers/fingerprint/fs9501/Kconfig"
source "drivers/fingerprint/gf9118/Kconfig"
source "drivers/fingerprint/gf9518/Kconfig"
endmenu
```

## drivers/fingerprint/fs9501/Kconfig
```kconfig
config BBK_FS9501
	tristate "SYNAPTICS OEM fingerprint FS9501 support"
	help
	  Say Y here to enable synaptics fingerprint driver support!
```

## drivers/fingerprint/gf5288/Kconfig
```kconfig
config BBK_GOODIX5288
	tristate "Goodix GF5288 fingerprint drvier support"
	help
	  Say Y here to enable goodix fingerprint driver support!
```

## drivers/fingerprint/gf9118/Kconfig
```kconfig
config BBK_GOODIX9118
	tristate "Goodix GF9118 fingerprint drvier support"
	help
	  Say Y here to enable goodix fingerprint driver support!
```

## drivers/fingerprint/gf9518/Kconfig
```kconfig
config BBK_GOODIX9518
	tristate "Goodix GF9518 fingerprint drvier support"
	help
	  Say Y here to enable goodix fingerprint driver support!
```

## sound/soc/vivo/Kconfig
```kconfig
config VIVO_REGDUMP
	bool "vivo audio register dump enable"
		
config SND_HIFI_CODEC_COMMON
	bool "Enable HiFi Codec Common Support"
	help
		For HiFi Codec Common Support.

config SND_HIFI_CODEC_TD1608
	bool "Enable VIVO codec for TD1608"
	help
		To add support for SoC audio on HiFi codec for TD1608.

config SND_HIFI_CODEC_PD1710
	bool "Enable VIVO codec for PD1710"
	help
		To add support for SoC audio on HiFi codec for PD1710.

config SND_TFA98XX
	bool "Enable TFA98XX"
	help
		To add support for SoC audio on TFA98XX.
		
config SND_AK4376
	bool "Enable ak4376 DAC"
	help
		To add support headphone hifi music performance

config SND_SOC_MAX98927
	bool "Enable MAX98927"
	help
		To add support for SoC audio on MAX98927.

config SND_ES9118
	bool "Enable ES9118 DAC"
	help
		To add support for SoC audio on ES9118.

config SND_VIVO_AUDIO_TEST
	bool "Enable vivo audio stress test"
	help
		To add support for SoC audio stress test.
```

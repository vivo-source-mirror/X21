/* Copyright (c) 2013, The Linux Foundation. All rights reserved.
 *
 * This program is free software; you can redistribute it and/or modify
 * it under the terms of the GNU General Public License version 2 and
 * only version 2 as published by the Free Software Foundation.
 *
 * This program is distributed in the hope that it will be useful,
 * but WITHOUT ANY WARRANTY; without even the implied warranty of
 * MERCHANTABILITY or FITNESS FOR A PARTICULAR PURPOSE.  See the
 * GNU General Public License for more details.
 */

/*---------------------------------------------------------------------------
 * This file is autogenerated file using gcdb parser. Please do not edit it.
 * Update input XML file to add a new entry or update variable in this file
 * VERSION = "1.0"
 *---------------------------------------------------------------------------*/
&mdss_mdp {
	dsi_pd1730_tianma_nt36672a_1080plus_video: qcom,mdss_dsi_pd1730_tianma_nt36672a_1080plus_video {
		qcom,mdss-dsi-panel-name = "mdss_dsi_pd1730_tianma_nt36672a_1080plus_video";
		qcom,mdss-dsi-panel-controller = <&mdss_dsi0>;
		qcom,mdss-dsi-panel-type = "dsi_video_mode";
		qcom,mdss-dsi-project-name = "pd1730";
		qcom,mdss-dsi-panel-destination = "display_1";
		qcom,mdss-dsi-panel-framerate = <60>;
		//qcom,mdss-dsi-panel-clk-mipi-max = <996605504>; //type:966605504, max:
		//qcom,mdss-dsi-panel-clockrate =<655000000>;
		qcom,mdss-dsi-virtual-channel-id = <0>;
		qcom,mdss-dsi-stream = <0>;
		qcom,mdss-dsi-panel-id = <0x10>;
		qcom,mdss-dsi-panel-width = <1080>;
		qcom,mdss-dsi-panel-height = <2280>;

		qcom,mdss-dsi-h-front-porch = <20>;
		qcom,mdss-dsi-h-back-porch = <290>;
		qcom,mdss-dsi-h-pulse-width = <4>;
		qcom,mdss-dsi-h-sync-skew = <0>;
		qcom,mdss-dsi-v-front-porch = <2>;/*16*/
		qcom,mdss-dsi-v-back-porch = <12>;/*25*/
		qcom,mdss-dsi-v-pulse-width = <7>;

		qcom,mdss-dsi-h-front-porch-russia = <105>;////16
		qcom,mdss-dsi-h-back-porch-russia = <124>;////25
		//qcom,mdss-dsi-h-pulse-width = <14>;////4
		//qcom,mdss-dsi-h-sync-skew = <0>;
		qcom,mdss-dsi-v-front-porch-russia = <190>;////190
		qcom,mdss-dsi-v-back-porch-russia = <37>;
		//qcom,mdss-dsi-v-pulse-width = <8>;

		qcom,mdss-dsi-h-left-border = <0>;
		qcom,mdss-dsi-h-right-border = <0>;
		qcom,mdss-dsi-v-top-border = <0>;
		qcom,mdss-dsi-v-bottom-border = <0>;
		qcom,mdss-dsi-bpp = <24>;
		qcom,mdss-dsi-underflow-color = <0x00>;
		qcom,mdss-dsi-border-color = <0>;
		qcom,mdss-dsi-pixel-packing = "tight";
		qcom,mdss-dsi-on-command = [

29 01 00 00 00 00 02 FF 25
29 01 00 00 00 00 02 FB 01
29 01 00 00 00 00 02 05 04
29 01 00 00 00 00 02 FF 20
29 01 00 00 00 00 02 FB 01
29 01 00 00 00 00 02 62 BD

39 01 00 00 00 00 02 FF 23/*cabc 2 mode start*/
39 01 00 00 00 00 02 FB 01
39 01 00 00 00 00 02 08 04/*PWM rate to 30 KHz*/
39 01 00 00 00 00 02 11 01
39 01 00 00 00 00 02 12 7E
39 01 00 00 00 00 02 15 6E
39 01 00 00 00 00 02 16 0B
39 01 00 00 00 00 02 45 FF
39 01 00 00 00 00 02 46 F6
39 01 00 00 00 00 02 47 ED
39 01 00 00 00 00 02 48 E6
39 01 00 00 00 00 02 49 DF
39 01 00 00 00 00 02 4A D8
39 01 00 00 00 00 02 4B D3
39 01 00 00 00 00 02 4C CE
39 01 00 00 00 00 02 4D C9
39 01 00 00 00 00 02 4E C4
39 01 00 00 00 00 02 4F C1
39 01 00 00 00 00 02 50 BE
39 01 00 00 00 00 02 51 BB
39 01 00 00 00 00 02 52 B8
39 01 00 00 00 00 02 53 B6
39 01 00 00 00 00 02 54 B5
39 01 00 00 00 00 02 58 FF
39 01 00 00 00 00 02 59 F6
39 01 00 00 00 00 02 5A ED
39 01 00 00 00 00 02 5B E6
39 01 00 00 00 00 02 5C DF
39 01 00 00 00 00 02 5D D8
39 01 00 00 00 00 02 5E D3
39 01 00 00 00 00 02 5F CE
39 01 00 00 00 00 02 60 C9
39 01 00 00 00 00 02 61 C4
39 01 00 00 00 00 02 62 C1
39 01 00 00 00 00 02 63 BE
39 01 00 00 00 00 02 64 BB
39 01 00 00 00 00 02 65 B8
39 01 00 00 00 00 02 66 B6
39 01 00 00 00 00 02 67 B5

39 01 00 00 00 00 02 FF 10
39 01 00 00 00 00 02 FB 01
39 01 00 00 00 00 02 51 FF
39 01 00 00 00 00 02 53 24
39 01 00 00 00 00 02 55 00/*cabc 2 mode end*/
39 01 00 00 00 00 06 3B 03 0E 07 04 04
29 01 00 00 00 00 02 35 00

39 01 00 00 00 00 02 FF 24
39 01 00 00 00 00 02 FB 01
39 01 00 00 00 00 02 1D 1C
39 01 00 00 00 00 02 1E 1C
39 01 00 00 00 00 02 1F 1C
39 01 00 00 00 00 02 20 1C
39 01 00 00 00 00 02 21 1C
39 01 00 00 00 00 02 22 1C
39 01 00 00 00 00 02 FF 10
39 01 00 00 00 00 02 FB 01

29 01 00 00 78 00 02 11 00 
29 01 00 00 14 00 02 29 00

		];
		qcom,mdss-dsi-on-cabc-levle1 = [
29 01 00 00 00 00 03 50 5A 23
//29 01 00 00 00 00 03 90 ff 0f
29 01 00 00 00 00 03 94 2C 01
29 01 00 00 00 00 03 50 00 2F
		];

		qcom,mdss-dsi-on-cabc-levle2 = [
29 01 00 00 00 00 03 50 5A 23
//29 01 00 00 00 00 03 90 ff 0f
29 01 00 00 00 00 03 94 2C 02
29 01 00 00 00 00 03 50 00 2F
		];

		qcom,mdss-dsi-on-cabc-levle3 = [
29 01 00 00 00 00 03 50 5A 23
//29 01 00 00 00 00 03 90 ff 0f
29 01 00 00 00 00 03 94 2C 03
29 01 00 00 00 00 03 50 00 2F
		];
		qcom,mdss-dsi-on-cabc-off = [
29 01 00 00 00 00 03 50 5A 23
//29 01 00 00 00 00 03 90 ff 0f
29 01 00 00 00 00 03 94 2c 00
29 01 00 00 00 00 03 50 00 2F
		];
		qcom,mdss-dsi-off-command = [

					39 01 00 00 14 00 02 28 00
					39 01 00 00 50 00 02 10 00/*reset down 70ms later than 0x10*/
					/*39 01 00 00 00 00 02 04 5A
					39 01 00 00 00 00 02 05 5A*/
					];
		qcom,mdss-dsi-on-command-state = "dsi_lp_mode";
		qcom,mdss-dsi-off-command-state = "dsi_lp_mode";
		qcom,mdss-dsi-h-sync-pulse = <1>;
		/*qcom,mdss-dsi-traffic-mode = "non_burst_sync_event";*/
		qcom,mdss-dsi-traffic-mode = "non_burst_sync_pulse";
		qcom,mdss-dsi-bllp-eof-power-mode;
		qcom,mdss-dsi-bllp-power-mode;
		/*qcom,mdss-dsi-hbp-power-mode;*/
		qcom,mdss-dsi-tx-eot-append;
		qcom,mdss-dsi-lane-0-state;
		qcom,mdss-dsi-lane-1-state;
		qcom,mdss-dsi-lane-2-state;
		qcom,mdss-dsi-lane-3-state;
		qcom,mdss-dsi-lp11-init;
		/*qcom,mdss-dsi-init-delay-us = <15000>;*/
		//qcom,mdss-dsi-panel-timings = [88 1C 12 00 42 44 18 20 16 03 04 00];

		qcom,mdss-dsi-panel-timings-phy-v2 = [
		10 21 0A 0C 07 03 04 a0
		10 21 0A 0C 07 03 04 a0
		10 21 0A 0C 07 03 04 a0
		10 21 0A 0C 07 03 04 a0
		10 23 0A 0C 07 03 04 a0];
		qcom,mdss-dsi-t-clk-post = <0x01>;
		qcom,mdss-dsi-t-clk-pre = <0x3B>;//0x1B

		qcom,mdss-dsi-panel-russia-timings-phy-v2 = [
		22 1E 07 08 04 03 04 a0
		22 1E 07 08 04 03 04 a0
		22 1E 07 08 04 03 04 a0
		22 1E 07 08 04 03 04 a0
		22 17 07 08 04 03 04 a0];
		qcom,mdss-dsi-t-clk-post-russia = <0x0C>;
		qcom,mdss-dsi-t-clk-pre-russia = <0x2B>;

		qcom,mdss-dsi-bl-min-level = <1>;
		qcom,mdss-dsi-bl-max-level = <2047>;
		qcom,panel-supply-entries = <&dsi_panel_pwr_supply_no_labibb>;
		qcom,mdss-dsi-dma-trigger = "trigger_sw";
		qcom,mdss-dsi-mdp-trigger = "none";
		qcom,mdss-dsi-bl-pmic-control-type = "bl_i2c";
		qcom,mdss-dsi-reset-sequence = <1 5>, <0 5>, <1 15>;
		qcom,mdss-pan-physical-width-dimension = <68>;////68.04
		qcom,mdss-pan-physical-height-dimension = <144>;////143.64 from wuhan 1208
		/*qcom,suspend-ulps-enabled;*/

		//ESD  read register check
		//qcom,esd-check-enabled;
		qcom,mdss-dsi-panel-status-command = [06 01 00 01 05 00 02 0A 08];
		qcom,mdss-dsi-panel-status-command-state = "dsi_lp_mode";
		qcom,mdss-dsi-panel-status-check-mode = "reg_read";
		qcom,mdss-dsi-panel-status-value = <0x1c>;
		qcom,mdss-dsi-panel-status-read-length = <1>;
		qcom,mdss-dsi-panel-max-error-count = <10>;

	};
};

/* Copyright (c) 2016-2017, The Linux Foundation. All rights reserved.
 *
 * This program is free software; you can redistribute it and/or modify
 * it under the terms of the GNU General Public License version 2 and
 * only version 2 as published by the Free Software Foundation.
 *
 * This program is distributed in the hope that it will be useful,
 * but WITHOUT ANY WARRANTY; without even the implied warranty of
 * MERCHANTABILITY or FITNESS FOR A PARTICULAR PURPOSE.  See the
 * GNU General Public License for more details.
 */

/* first */
qcom,bbk_pd1728_3080mah_first {
	/* #3457777_BBK_BD7_3200mAh_Master_Apr27th2018*/
	qcom,max-voltage-uv = <4380000>;
	qcom,nom-batt-capacity-mah = <3080>;
	qcom,fg-cc-cv-threshold-mv = <4370>;
	qcom,batt-id-kohm = <400>;
	qcom,battery-beta = <3380>;
	qcom,battery-type = "bbk_pd1728atl_3080mah_first";
	qcom,checksum = <0xC989>;
	qcom,gui-version = "PM660GUI - 0.0.0.45";
	qcom,fg-profile-data = [
		 97 21 C5 0D
		 D9 0B 1A 05
		 FE 1C EB FA
		 85 05 ED 02
		 3B 18 2E 23
		 52 45 16 53
		 95 00 00 00
		 12 00 00 00
		 00 00 61 CD
		 72 C4 A6 CB
		 1D 00 08 00
		 8F E2 CC ED
		 BF 06 9F 00
		 D3 01 38 13
		 77 FD 36 32
		 1E 06 09 20
		 27 00 14 00
		 DD 1F 67 05
		 A6 0A 25 FC
		 BF 1C FE 02
		 FB 15 30 12
		 88 18 90 23
		 60 44 90 5A
		 6B 00 00 00
		 0F 00 00 00
		 00 00 D8 D5
		 8D CA 9D BA
		 1C 00 00 00
		 22 EB CC ED
		 E7 06 06 F2
		 F2 06 6D 02
		 43 FC F1 1A
		 BA 33 CC FF
		 07 10 00 00
		 64 0C 14 46
		 1C 00 40 00
		 94 01 0A FA
		 FF 00 00 00
		 00 00 00 00
		 00 00 00 00
		 00 00 00 00
		 00 00 00 00
		 00 00 00 00
		 00 00 00 00
		 00 00 00 00
		 00 00 00 00
		 00 00 00 00
		 00 00 00 00
		 00 00 00 00
		 00 00 00 00
		 00 00 00 00
		 00 00 00 00
		 00 00 00 00
		 00 00 00 00
		 00 00 00 00
		 00 00 00 00
	];

	vivo,msoc-mapping-enable;
	vivo,msoc-mapping-col-legend = <2>;
	vivo,msoc-mapping-row-legend = <256>;
	vivo,msoc-mapping-data =
	<0 0>,
	<1 1>,
	<2 2>,
	<3 3>,
	<4 4>,
	<5 5>,
	<6 6>,
	<7 7>,//+
	<8 7>,
	<9 8>,
	<10 9>,
	<11 10>,
	<12 11>,
	<13 12>,
	<14 13>,
	<15 14>,
	<16 15>,//+
	<17 15>,
	<18 16>,
	<19 17>,
	<20 18>,
	<21 19>,
	<22 20>,
	<23 21>,
	<24 21>,//+
	<25 22>,
	<26 23>,
	<27 24>,
	<28 25>,
	<29 26>,
	<30 27>,
	<31 28>,
	<32 29>,
	<33 30>,
	<34 31>,
	<35 32>,
	<36 33>,
	<37 34>,
	<38 35>,
	<39 36>,
	<40 37>,
	<41 38>,
	<42 39>,
	<43 40>,
	<44 41>,
	<45 42>,
	<46 43>,
	<47 44>,
	<48 45>,
	<49 46>,
	<50 47>,
	<51 48>,
	<52 49>,
	<53 50>,
	<54 51>,
	<55 52>,
	<56 53>,
	<57 54>,
	<58 55>,
	<59 56>,
	<60 57>,
	<61 58>,
	<62 59>,
	<63 60>,
	<64 61>,
	<65 62>,
	<66 63>,
	<67 64>,
	<68 65>,
	<69 66>,
	<70 67>,
	<71 68>,
	<72 69>,
	<73 70>,
	<74 71>,
	<75 72>,
	<76 73>,
	<77 74>,
	<78 75>,
	<79 76>,
	<80 77>,
	<81 78>,
	<82 79>,
	<83 80>,
	<84 81>,
	<85 82>,
	<86 83>,
	<87 84>,
	<88 85>,
	<89 86>,
	<90 87>,
	<91 88>,
	<92 89>,
	<93 90>,
	<94 91>,
	<95 92>,
	<96 93>,
	<97 94>,
	<98 95>,
	<99 96>,
	<100 97>,
	<101 98>,
	<102 99>,
	<103 100>,
	<104 101>,
	<105 102>,
	<106 103>,
	<107 104>,
	<108 105>,
	<109 106>,
	<110 107>,
	<111 108>,
	<112 109>,
	<113 110>,
	<114 111>,
	<115 112>,
	<116 113>,//-
	<117 115>,
	<118 116>,
	<119 117>,
	<120 118>,
	<121 119>,
	<122 120>,
	<123 121>,
	<124 122>,
	<125 123>,
	<126 124>,
	<127 125>,
	<128 126>,
	<129 127>,
	<130 128>,
	<131 129>,
	<132 130>,
	<133 131>,
	<134 132>,
	<135 133>,
	<136 134>,
	<137 135>,
	<138 136>,
	<139 137>,
	<140 138>,//-
	<141 140>,
	<142 141>,
	<143 142>,
	<144 143>,
	<145 144>,
	<146 145>,
	<147 146>,
	<148 147>,
	<149 148>,
	<150 149>,
	<151 150>,
	<152 151>,
	<153 152>,
	<154 153>,
	<155 154>,
	<156 155>,
	<157 156>,
	<158 157>,
	<159 158>,
	<160 159>,
	<161 160>,
	<162 161>,
	<163 162>,
	<164 163>,
	<165 164>,
	<166 165>,
	<167 166>,
	<168 167>,
	<169 168>,
	<170 169>,
	<171 170>,
	<172 171>,
	<173 172>,
	<174 173>,
	<175 174>,
	<176 175>,
	<177 176>,
	<178 177>,
	<179 178>,
	<180 179>,
	<181 180>,
	<182 181>,
	<183 182>,
	<184 183>,
	<185 184>,
	<186 185>,
	<187 186>,
	<188 187>,
	<189 188>,
	<190 189>,
	<191 190>,
	<192 191>,
	<193 192>,
	<194 193>,
	<195 194>,
	<196 195>,
	<197 196>,
	<198 197>,
	<199 198>,
	<200 199>,
	<201 200>,
	<202 201>,
	<203 202>,
	<204 203>,
	<205 204>,
	<206 205>,
	<207 206>,
	<208 207>,
	<209 208>,
	<210 209>,
	<211 210>,
	<212 211>,
	<213 212>,
	<214 213>,
	<215 214>,
	<216 215>,
	<217 216>,
	<218 217>,
	<219 218>,
	<220 219>,
	<221 220>,
	<222 221>,
	<223 222>,
	<224 223>,
	<225 224>,
	<226 225>,
	<227 226>,
	<228 227>,
	<229 228>,
	<230 229>,
	<231 230>,
	<232 231>,
	<233 232>,
	<234 233>,
	<235 234>,
	<236 235>,
	<237 236>,
	<238 237>,
	<239 238>,
	<240 239>,
	<241 240>,
	<242 241>,
	<243 242>,
	<244 243>,
	<245 244>,
	<246 245>,
	<247 246>,
	<248 247>,
	<249 248>,
	<250 249>,
	<251 250>,
	<252 251>,
	<253 252>,
	<254 253>,//-
	<255 255>;
};

/* second */
qcom,bbk_pd1728_3080mah_second {
	/* #3457777_BBK_BD7_3200mAh_Master_Apr27th2018*/
	qcom,max-voltage-uv = <4380000>;
	qcom,nom-batt-capacity-mah = <3080>;
	qcom,fg-cc-cv-threshold-mv = <4370>;
	qcom,batt-id-kohm = <500>;
	qcom,battery-beta = <3380>;
	qcom,battery-type = "bbk_pd1728atl_3080mah_second";
	qcom,checksum = <0xC989>;
	qcom,gui-version = "PM660GUI - 0.0.0.45";
	qcom,fg-profile-data = [
		 97 21 C5 0D
		 D9 0B 1A 05
		 FE 1C EB FA
		 85 05 ED 02
		 3B 18 2E 23
		 52 45 16 53
		 95 00 00 00
		 12 00 00 00
		 00 00 61 CD
		 72 C4 A6 CB
		 1D 00 08 00
		 8F E2 CC ED
		 BF 06 9F 00
		 D3 01 38 13
		 77 FD 36 32
		 1E 06 09 20
		 27 00 14 00
		 DD 1F 67 05
		 A6 0A 25 FC
		 BF 1C FE 02
		 FB 15 30 12
		 88 18 90 23
		 60 44 90 5A
		 6B 00 00 00
		 0F 00 00 00
		 00 00 D8 D5
		 8D CA 9D BA
		 1C 00 00 00
		 22 EB CC ED
		 E7 06 06 F2
		 F2 06 6D 02
		 43 FC F1 1A
		 BA 33 CC FF
		 07 10 00 00
		 64 0C 14 46
		 1C 00 40 00
		 94 01 0A FA
		 FF 00 00 00
		 00 00 00 00
		 00 00 00 00
		 00 00 00 00
		 00 00 00 00
		 00 00 00 00
		 00 00 00 00
		 00 00 00 00
		 00 00 00 00
		 00 00 00 00
		 00 00 00 00
		 00 00 00 00
		 00 00 00 00
		 00 00 00 00
		 00 00 00 00
		 00 00 00 00
		 00 00 00 00
		 00 00 00 00
		 00 00 00 00
	];

	vivo,msoc-mapping-enable;
	vivo,msoc-mapping-col-legend = <2>;
	vivo,msoc-mapping-row-legend = <256>;
	vivo,msoc-mapping-data =
	<0 0>,
	<1 1>,
	<2 2>,
	<3 3>,
	<4 4>,
	<5 5>,
	<6 6>,
	<7 7>,//+
	<8 7>,
	<9 8>,
	<10 9>,
	<11 10>,
	<12 11>,
	<13 12>,
	<14 13>,
	<15 14>,
	<16 15>,//+
	<17 15>,
	<18 16>,
	<19 17>,
	<20 18>,
	<21 19>,
	<22 20>,
	<23 21>,
	<24 21>,//+
	<25 22>,
	<26 23>,
	<27 24>,
	<28 25>,
	<29 26>,
	<30 27>,
	<31 28>,
	<32 29>,
	<33 30>,
	<34 31>,
	<35 32>,
	<36 33>,
	<37 34>,
	<38 35>,
	<39 36>,
	<40 37>,
	<41 38>,
	<42 39>,
	<43 40>,
	<44 41>,
	<45 42>,
	<46 43>,
	<47 44>,
	<48 45>,
	<49 46>,
	<50 47>,
	<51 48>,
	<52 49>,
	<53 50>,
	<54 51>,
	<55 52>,
	<56 53>,
	<57 54>,
	<58 55>,
	<59 56>,
	<60 57>,
	<61 58>,
	<62 59>,
	<63 60>,
	<64 61>,
	<65 62>,
	<66 63>,
	<67 64>,
	<68 65>,
	<69 66>,
	<70 67>,
	<71 68>,
	<72 69>,
	<73 70>,
	<74 71>,
	<75 72>,
	<76 73>,
	<77 74>,
	<78 75>,
	<79 76>,
	<80 77>,
	<81 78>,
	<82 79>,
	<83 80>,
	<84 81>,
	<85 82>,
	<86 83>,
	<87 84>,
	<88 85>,
	<89 86>,
	<90 87>,
	<91 88>,
	<92 89>,
	<93 90>,
	<94 91>,
	<95 92>,
	<96 93>,
	<97 94>,
	<98 95>,
	<99 96>,
	<100 97>,
	<101 98>,
	<102 99>,
	<103 100>,
	<104 101>,
	<105 102>,
	<106 103>,
	<107 104>,
	<108 105>,
	<109 106>,
	<110 107>,
	<111 108>,
	<112 109>,
	<113 110>,
	<114 111>,
	<115 112>,
	<116 113>,//-
	<117 115>,
	<118 116>,
	<119 117>,
	<120 118>,
	<121 119>,
	<122 120>,
	<123 121>,
	<124 122>,
	<125 123>,
	<126 124>,
	<127 125>,
	<128 126>,
	<129 127>,
	<130 128>,
	<131 129>,
	<132 130>,
	<133 131>,
	<134 132>,
	<135 133>,
	<136 134>,
	<137 135>,
	<138 136>,
	<139 137>,
	<140 138>,//-
	<141 140>,
	<142 141>,
	<143 142>,
	<144 143>,
	<145 144>,
	<146 145>,
	<147 146>,
	<148 147>,
	<149 148>,
	<150 149>,
	<151 150>,
	<152 151>,
	<153 152>,
	<154 153>,
	<155 154>,
	<156 155>,
	<157 156>,
	<158 157>,
	<159 158>,
	<160 159>,
	<161 160>,
	<162 161>,
	<163 162>,
	<164 163>,
	<165 164>,
	<166 165>,
	<167 166>,
	<168 167>,
	<169 168>,
	<170 169>,
	<171 170>,
	<172 171>,
	<173 172>,
	<174 173>,
	<175 174>,
	<176 175>,
	<177 176>,
	<178 177>,
	<179 178>,
	<180 179>,
	<181 180>,
	<182 181>,
	<183 182>,
	<184 183>,
	<185 184>,
	<186 185>,
	<187 186>,
	<188 187>,
	<189 188>,
	<190 189>,
	<191 190>,
	<192 191>,
	<193 192>,
	<194 193>,
	<195 194>,
	<196 195>,
	<197 196>,
	<198 197>,
	<199 198>,
	<200 199>,
	<201 200>,
	<202 201>,
	<203 202>,
	<204 203>,
	<205 204>,
	<206 205>,
	<207 206>,
	<208 207>,
	<209 208>,
	<210 209>,
	<211 210>,
	<212 211>,
	<213 212>,
	<214 213>,
	<215 214>,
	<216 215>,
	<217 216>,
	<218 217>,
	<219 218>,
	<220 219>,
	<221 220>,
	<222 221>,
	<223 222>,
	<224 223>,
	<225 224>,
	<226 225>,
	<227 226>,
	<228 227>,
	<229 228>,
	<230 229>,
	<231 230>,
	<232 231>,
	<233 232>,
	<234 233>,
	<235 234>,
	<236 235>,
	<237 236>,
	<238 237>,
	<239 238>,
	<240 239>,
	<241 240>,
	<242 241>,
	<243 242>,
	<244 243>,
	<245 244>,
	<246 245>,
	<247 246>,
	<248 247>,
	<249 248>,
	<250 249>,
	<251 250>,
	<252 251>,
	<253 252>,
	<254 253>,//-
	<255 255>;
};

/* third */
qcom,bbk_pd1728_3080mah_third {
/* #3296075_BBK_PD1728_3080mAh_averaged_MasterSlave_Jan8th2018*/
	qcom,max-voltage-uv = <4380000>;
	qcom,nom-batt-capacity-mah = <3080>;
	qcom,batt-id-kohm = <700>;
	qcom,fg-cc-cv-threshold-mv = <4370>;
	qcom,battery-beta = <3380>;
	qcom,battery-type = "pd1728_3080mah_sdi_third-5dian";
	qcom,checksum = <0x0BD8>;
	qcom,gui-version = "PM660GUI - 0.0.0.45";
	qcom,fg-profile-data = [
		 C0 20 5B 04
		 57 0B 80 05
		 EF 1C 11 FB
		 50 05 26 03
		 5F 18 FB 22
		 90 45 BB 52
		 8D 00 00 00
		 13 00 00 00
		 00 00 5B C3
		 52 D5 48 C2
		 2E 00 08 00
		 CB E3 7E ED
		 32 05 E3 01
		 CE 04 4E 12
		 39 F4 A5 2A
		 31 06 09 20
		 27 00 14 00
		 32 20 16 05
		 E0 0A DB 05
		 CA 1C D3 02
		 6F 0C C0 0B
		 9E 18 69 23
		 A4 44 4D 5A
		 72 00 00 00
		 0F 00 00 00
		 00 00 F4 07
		 86 CA 17 CA
		 27 00 00 00
		 1F EB 7E ED
		 0B 06 38 01
		 EE 05 77 EB
		 15 02 F1 23
		 D8 33 CC FF
		 07 10 00 00
		 2F 0C 14 46
		 27 00 40 00
		 70 01 0A FA
		 FF 00 00 00
		 00 00 00 00
		 00 00 00 00
		 00 00 00 00
		 00 00 00 00
		 00 00 00 00
		 00 00 00 00
		 00 00 00 00
		 00 00 00 00
		 00 00 00 00
		 00 00 00 00
		 00 00 00 00
		 00 00 00 00
		 00 00 00 00
		 00 00 00 00
		 00 00 00 00
		 00 00 00 00
		 00 00 00 00
		 00 00 00 00
	];

	vivo,msoc-mapping-enable;
	vivo,msoc-mapping-col-legend = <2>;
	vivo,msoc-mapping-row-legend = <256>;
	vivo,msoc-mapping-data =
	<0 0>,
	<1 1>,
	<2 2>,
	<3 3>,
	<4 4>,
	<5 5>,
	<6 6>,
	<7 7>,
	<8 8>,
	<9 9>,
	<10 10>,
	<11 11>,
	<12 12>,
	<13 13>,
	<14 14>,
	<15 15>,
	<16 16>,//+
	<17 16>,
	<18 17>,
	<19 18>,
	<20 19>,
	<21 20>,
	<22 21>,
	<23 22>,
	<24 23>,
	<25 24>,
	<26 25>,
	<27 26>,//+
	<28 26>,
	<29 27>,
	<30 28>,
	<31 29>,
	<32 30>,//+
	<33 30>,
	<34 31>,
	<35 32>,
	<36 33>,
	<37 34>,
	<38 35>,
	<39 36>,
	<40 37>,
	<41 38>,
	<42 39>,
	<43 40>,
	<44 41>,
	<45 42>,
	<46 43>,//+
	<47 43>,
	<48 44>,
	<49 45>,
	<50 46>,
	<51 47>,
	<52 48>,
	<53 49>,//+
	<54 49>,
	<55 50>,
	<56 51>,
	<57 52>,
	<58 53>,
	<59 54>,
	<60 55>,
	<61 56>,
	<62 57>,
	<63 58>,
	<64 59>,
	<65 60>,
	<66 61>,
	<67 62>,
	<68 63>,
	<69 64>,
	<70 65>,
	<71 66>,
	<72 67>,
	<73 68>,
	<74 69>,
	<75 70>,
	<76 71>,
	<77 72>,
	<78 73>,
	<79 74>,
	<80 75>,
	<81 76>,
	<82 77>,
	<83 78>,
	<84 79>,
	<85 80>,
	<86 81>,
	<87 82>,
	<88 83>,
	<89 84>,
	<90 85>,
	<91 86>,
	<92 87>,
	<93 88>,
	<94 89>,
	<95 90>,
	<96 91>,
	<97 92>,
	<98 93>,
	<99 94>,
	<100 95>,
	<101 96>,
	<102 97>,
	<103 98>,
	<104 99>,
	<105 100>,
	<106 101>,
	<107 102>,//-
	<108 104>,
	<109 105>,
	<110 106>,
	<111 107>,
	<112 108>,
	<113 109>,
	<114 110>,
	<115 111>,
	<116 112>,
	<117 113>,
	<118 114>,
	<119 115>,//-
	<120 117>,
	<121 118>,
	<122 119>,
	<123 120>,
	<124 121>,
	<125 122>,
	<126 123>,
	<127 124>,
	<128 125>,
	<129 126>,
	<130 127>,
	<131 128>,
	<132 129>,
	<133 130>,//-
	<134 132>,
	<135 133>,
	<136 134>,
	<137 135>,
	<138 136>,
	<139 137>,
	<140 138>,
	<141 139>,
	<142 140>,
	<143 141>,
	<144 142>,
	<145 143>,
	<146 144>,
	<147 145>,
	<148 146>,
	<149 147>,
	<150 148>,
	<151 149>,
	<152 150>,
	<153 151>,
	<154 152>,
	<155 153>,
	<156 154>,
	<157 155>,
	<158 156>,
	<159 157>,
	<160 158>,
	<161 159>,
	<162 160>,
	<163 161>,
	<164 162>,
	<165 163>,
	<166 164>,
	<167 165>,
	<168 166>,//-
	<169 168>,
	<170 169>,
	<171 170>,
	<172 171>,
	<173 172>,
	<174 173>,
	<175 174>,
	<176 175>,
	<177 176>,
	<178 177>,
	<179 178>,
	<180 179>,
	<181 180>,
	<182 181>,
	<183 182>,
	<184 183>,
	<185 184>,
	<186 185>,
	<187 186>,
	<188 187>,
	<189 188>,
	<190 189>,
	<191 190>,
	<192 191>,
	<193 192>,
	<194 193>,
	<195 194>,
	<196 195>,
	<197 196>,
	<198 197>,
	<199 198>,
	<200 199>,
	<201 200>,
	<202 201>,
	<203 202>,
	<204 203>,
	<205 204>,
	<206 205>,
	<207 206>,
	<208 207>,
	<209 208>,
	<210 209>,
	<211 210>,
	<212 211>,
	<213 212>,
	<214 213>,
	<215 214>,
	<216 215>,
	<217 216>,
	<218 217>,
	<219 218>,
	<220 219>,
	<221 220>,
	<222 221>,
	<223 222>,
	<224 223>,
	<225 224>,
	<226 225>,
	<227 226>,
	<228 227>,
	<229 228>,
	<230 229>,
	<231 230>,
	<232 231>,
	<233 232>,
	<234 233>,
	<235 234>,
	<236 235>,
	<237 236>,
	<238 237>,
	<239 238>,
	<240 239>,
	<241 240>,
	<242 241>,
	<243 242>,
	<244 243>,
	<245 244>,
	<246 245>,
	<247 246>,
	<248 247>,
	<249 248>,
	<250 249>,
	<251 250>,
	<252 251>,
	<253 252>,
	<254 253>,//-
	<255 255>;
};


/* Copyright (c) 2016-2017, The Linux Foundation. All rights reserved.
 *
 * This program is free software; you can redistribute it and/or modify
 * it under the terms of the GNU General Public License version 2 and
 * only version 2 as published by the Free Software Foundation.
 *
 * This program is distributed in the hope that it will be useful,
 * but WITHOUT ANY WARRANTY; without even the implied warranty of
 * MERCHANTABILITY or FITNESS FOR A PARTICULAR PURPOSE.  See the
 * GNU General Public License for more details.
 */

/* first */
qcom,bbk_pd1816_atl_3475mah_first {
	/* #3606881_BBK_BF1nvt_3475mAh_averaged_MasterSlave_Aug7th2018*/
	qcom,max-voltage-uv = <4380000>;
	qcom,nom-batt-capacity-mah = <3400>;
	qcom,batt-id-kohm = <100>;
	qcom,battery-beta = <3380>;
	qcom,fg-cc-cv-threshold-mv = <4370>;
	qcom,battery-type = "bbk_pd1816_atl_3475mah_first";
	qcom,checksum = <0xF666>;
	qcom,gui-version = "PM660GUI - 0.0.0.45";

	qcom,fg-profile-data = [
		 D5 21 9B 0D
		 13 12 C6 04
		 FE 1C 6C 01
		 A7 05 D9 02
		 13 18 0B 23
		 A2 45 86 52
		 95 00 00 00
		 14 00 00 00
		 00 00 19 CD
		 1C C5 6C CA
		 1F 00 08 00
		 7B E3 94 ED
		 FF 06 19 F2
		 79 FA 8B 12
		 39 FD 32 2A
		 1C 06 09 20
		 27 00 14 00
		 7B 20 AC 04
		 36 0B 87 05
		 D8 1C 84 02
		 F4 0C 3C 0B
		 90 18 19 23
		 4B 45 48 53
		 77 00 00 00
		 11 00 00 00
		 00 00 F7 07
		 3E CA AA AA
		 1D 00 00 00
		 1C EB 94 ED
		 8E F4 6C EB
		 FA 06 A6 02
		 17 FC F2 13
		 AA 33 CC FF
		 07 10 00 00
		 45 0D 14 46
		 1D 00 40 00
		 46 01 0A FA
		 FF 00 00 00
		 00 00 00 00
		 00 00 00 00
		 00 00 00 00
		 00 00 00 00
		 00 00 00 00
		 00 00 00 00
		 00 00 00 00
		 00 00 00 00
		 00 00 00 00
		 00 00 00 00
		 00 00 00 00
		 00 00 00 00
		 00 00 00 00
		 00 00 00 00
		 00 00 00 00
		 00 00 00 00
		 00 00 00 00
		 00 00 00 00
	];

	vivo,msoc-mapping-enable;
	vivo,msoc-mapping-col-legend = <2>;
	vivo,msoc-mapping-row-legend = <256>;
	vivo,msoc-mapping-data =
	<0 0>,
	<1 1>,
	<2 2>,
	<3 3>,
	<4 4>,
	<5 5>,
	<6 6>,
	<7 7>,//+
	<8 7>,
	<9 8>,
	<10 9>,
	<11 10>,
	<12 11>,
	<13 12>,
	<14 13>,
	<15 14>,
	<16 15>,//+
	<17 15>,
	<18 16>,
	<19 17>,
	<20 18>,
	<21 19>,
	<22 20>,
	<23 21>,
	<24 22>,
	<25 23>,
	<26 24>,
	<27 25>,
	<28 26>,
	<29 27>,
	<30 28>,
	<31 29>,
	<32 30>,
	<33 31>,
	<34 31>,//+
	<35 32>,
	<36 33>,
	<37 34>,
	<38 35>,
	<39 36>,
	<40 37>,
	<41 38>,
	<42 39>,
	<43 40>,
	<44 41>,
	<45 42>,
	<46 43>,//+
	<47 43>,
	<48 44>,
	<49 45>,
	<50 46>,
	<51 47>,
	<52 48>,
	<53 49>,
	<54 50>,
	<55 51>,
	<56 52>,
	<57 53>,
	<58 54>,
	<59 55>,
	<60 56>,
	<61 57>,
	<62 58>,
	<63 59>,
	<64 60>,
	<65 61>,
	<66 62>,
	<67 63>,
	<68 64>,
	<69 65>,
	<70 66>,
	<71 67>,
	<72 68>,
	<73 69>,
	<74 70>,
	<75 71>,
	<76 72>,
	<77 73>,
	<78 74>,
	<79 75>,
	<80 76>,
	<81 77>,
	<82 78>,
	<83 79>,
	<84 80>,
	<85 81>,
	<86 82>,
	<87 83>,
	<88 84>,
	<89 85>,
	<90 86>,
	<91 87>,
	<92 88>,
	<93 89>,
	<94 90>,
	<95 91>,
	<96 92>,
	<97 93>,
	<98 94>,
	<99 95>,
	<100 96>,
	<101 97>,
	<102 98>,
	<103 99>,
	<104 100>,
	<105 101>,
	<106 102>,
	<107 103>,
	<108 104>,
	<109 105>,
	<110 106>,
	<111 107>,
	<112 108>,
	<113 109>,
	<114 110>,
	<115 111>,
	<116 112>,//-
	<117 113>,
	<118 115>,
	<119 116>,
	<120 117>,
	<121 118>,
	<122 119>,
	<123 120>,
	<124 121>,
	<125 122>,
	<126 123>,
	<127 124>,
	<128 125>,
	<129 126>,
	<130 127>,
	<131 128>,
	<132 129>,
	<133 130>,
	<134 131>,
	<135 132>,
	<136 133>,
	<137 134>,
	<138 135>,
	<139 136>,
	<140 137>,//-
	<141 138>,
	<142 140>,
	<143 141>,
	<144 142>,
	<145 143>,
	<146 144>,
	<147 145>,
	<148 146>,
	<149 147>,
	<150 148>,
	<151 149>,
	<152 150>,
	<153 151>,
	<154 152>,
	<155 153>,
	<156 154>,
	<157 155>,
	<158 156>,
	<159 157>,
	<160 158>,
	<161 159>,
	<162 160>,
	<163 161>,
	<164 162>,
	<165 163>,
	<166 164>,
	<167 166>,//-
	<168 167>,
	<169 168>,
	<170 169>,
	<171 170>,
	<172 171>,
	<173 172>,
	<174 173>,
	<175 174>,
	<176 175>,
	<177 176>,
	<178 177>,
	<179 178>,
	<180 179>,
	<181 180>,
	<182 181>,
	<183 182>,
	<184 183>,
	<185 184>,
	<186 185>,
	<187 186>,
	<188 187>,
	<189 188>,
	<190 189>,
	<191 190>,
	<192 191>,
	<193 192>,
	<194 193>,
	<195 194>,
	<196 195>,
	<197 196>,
	<198 197>,
	<199 198>,
	<200 199>,
	<201 200>,
	<202 201>,
	<203 202>,
	<204 203>,
	<205 204>,
	<206 205>,
	<207 206>,
	<208 207>,
	<209 208>,
	<210 209>,
	<211 210>,
	<212 211>,
	<213 212>,
	<214 213>,
	<215 214>,
	<216 215>,
	<217 216>,
	<218 217>,
	<219 218>,
	<220 219>,
	<221 220>,
	<222 221>,
	<223 222>,
	<224 223>,
	<225 224>,
	<226 225>,
	<227 226>,
	<228 227>,
	<229 228>,
	<230 229>,
	<231 230>,
	<232 231>,
	<233 232>,
	<234 233>,
	<235 234>,
	<236 235>,
	<237 236>,
	<238 237>,
	<239 238>,
	<240 239>,
	<241 240>,
	<242 241>,
	<243 242>,
	<244 243>,
	<245 244>,
	<246 245>,
	<247 246>,
	<248 247>,
	<249 248>,
	<250 249>,
	<251 250>,
	<252 251>,
	<253 252>,
	<254 253>,//-
	<255 255>;
};

/* second */
qcom,bbk_pd1816_atl_3475mah_second {
	/* #3652406_BBK_BF1_3500mAh_averaged_MasterSlave_Sept4th2018*/
	qcom,max-voltage-uv = <4380000>;
	qcom,fg-cc-cv-threshold-mv = <4370>;
	qcom,nom-batt-capacity-mah = <3400>;
	qcom,batt-id-kohm = <200>;
	qcom,battery-beta = <3380>;
	qcom,battery-type = "bbk_pd1816_sdi_3475mah_second";
	qcom,checksum = <0x8E0C>;
	qcom,gui-version = "PM660GUI - 0.0.0.45";

	qcom,fg-profile-data = [
		 82 1F D8 05
		 22 0A BE 06
		 F7 1C 49 FB
		 B2 04 C5 03
		 50 18 4B 23
		 13 45 8F 53
		 80 00 00 00
		 11 00 00 00
		 00 00 BD BB
		 68 CC 00 8C
		 24 00 08 00
		 77 EA F3 EC
		 DA 05 B5 FA
		 8B 04 6E 12
		 BB 06 54 32
		 24 06 09 20
		 27 00 14 00
		 74 1F 00 06
		 13 0A 75 FD
		 D6 1C E1 02
		 02 0C 32 12
		 90 18 11 2A
		 8F 4D FE 5B
		 67 00 00 00
		 0D 00 00 00
		 00 00 FA D4
		 C1 CA 58 CB
		 1E 00 00 00
		 A5 EB F3 EC
		 84 06 6E F3
		 83 05 11 EB
		 82 0A 98 22
		 D4 33 CC FF
		 07 10 00 00
		 A6 0D 14 46
		 1E 00 40 00
		 76 01 0A FA
		 FF 00 00 00
		 00 00 00 00
		 00 00 00 00
		 00 00 00 00
		 00 00 00 00
		 00 00 00 00
		 00 00 00 00
		 00 00 00 00
		 00 00 00 00
		 00 00 00 00
		 00 00 00 00
		 00 00 00 00
		 00 00 00 00
		 00 00 00 00
		 00 00 00 00
		 00 00 00 00
		 00 00 00 00
		 00 00 00 00
		 00 00 00 00
	];

	vivo,msoc-mapping-enable;
	vivo,msoc-mapping-col-legend = <2>;
	vivo,msoc-mapping-row-legend = <256>;
	vivo,msoc-mapping-data =
	<0 0>,
	<1 1>,
	<2 2>,
	<3 3>,
	<4 4>,
	<5 5>,
	<6 6>,
	<7 7>,//+
	<8 7>,
	<9 8>,
	<10 9>,
	<11 10>,
	<12 11>,
	<13 12>,
	<14 13>,
	<15 14>,
	<16 15>,
	<17 16>,
	<18 17>,
	<19 18>,
	<20 19>,
	<21 20>,
	<22 21>,
	<23 22>,
	<24 23>,
	<25 24>,
	<26 25>,
	<27 25>,//++++++++++++
	<28 26>,
	<29 27>,
	<30 28>,
	<31 29>,
	<32 30>,
	<33 31>,
	<34 31>,//+
	<35 32>,
	<36 33>,
	<37 34>,
	<38 35>,
	<39 36>,
	<40 37>,
	<41 38>,
	<42 39>,
	<43 40>,
	<44 41>,
	<45 42>,
	<46 43>,//+
	<47 43>,
	<48 44>,
	<49 45>,
	<50 46>,
	<51 47>,
	<52 48>,
	<53 49>,
	<54 50>,
	<55 51>,
	<56 52>,
	<57 53>,//+++++
	<58 53>,
	<59 54>,
	<60 55>,
	<61 56>,
	<62 57>,
	<63 58>,
	<64 59>,
	<65 60>,
	<66 61>,
	<67 62>,
	<68 63>,
	<69 64>,
	<70 65>,
	<71 66>,
	<72 67>,//-------
	<73 69>,
	<74 70>,
	<75 71>,
	<76 72>,
	<77 73>,
	<78 74>,
	<79 75>,
	<80 76>,
	<81 77>,
	<82 78>,
	<83 79>,
	<84 80>,
	<85 81>,
	<86 82>,
	<87 83>,
	<88 84>,
	<89 85>,
	<90 86>,
	<91 87>,
	<92 88>,
	<93 89>,
	<94 90>,
	<95 91>,
	<96 92>,
	<97 93>,
	<98 94>,
	<99 95>,
	<100 96>,
	<101 97>,
	<102 98>,
	<103 99>,
	<104 100>,
	<105 101>,
	<106 102>,
	<107 103>,
	<108 104>,
	<109 105>,
	<110 106>,
	<111 107>,
	<112 108>,
	<113 109>,
	<114 110>,
	<115 111>,
	<116 112>,//-
	<117 113>,
	<118 115>,
	<119 116>,
	<120 117>,
	<121 118>,
	<122 119>,
	<123 120>,
	<124 121>,
	<125 122>,
	<126 123>,
	<127 124>,
	<128 125>,
	<129 126>,
	<130 127>,
	<131 128>,
	<132 129>,
	<133 130>,
	<134 131>,
	<135 132>,
	<136 133>,
	<137 134>,
	<138 135>,
	<139 136>,
	<140 137>,//-
	<141 138>,
	<142 140>,
	<143 141>,
	<144 142>,
	<145 143>,
	<146 144>,
	<147 145>,
	<148 146>,
	<149 147>,
	<150 148>,
	<151 149>,
	<152 150>,
	<153 151>,
	<154 152>,
	<155 153>,
	<156 154>,
	<157 155>,
	<158 156>,
	<159 157>,
	<160 158>,
	<161 159>,
	<162 160>,
	<163 161>,
	<164 162>,
	<165 163>,
	<166 164>,
	<167 166>,//-
	<168 167>,
	<169 168>,
	<170 169>,
	<171 170>,
	<172 171>,
	<173 172>,
	<174 173>,
	<175 174>,
	<176 175>,
	<177 176>,
	<178 177>,
	<179 178>,
	<180 179>,
	<181 180>,
	<182 181>,
	<183 182>,
	<184 183>,
	<185 184>,
	<186 185>,
	<187 186>,
	<188 187>,
	<189 188>,
	<190 189>,
	<191 190>,
	<192 191>,
	<193 192>,
	<194 193>,
	<195 194>,
	<196 195>,
	<197 196>,
	<198 197>,
	<199 198>,
	<200 199>,
	<201 200>,
	<202 201>,
	<203 202>,
	<204 203>,
	<205 204>,
	<206 205>,
	<207 206>,
	<208 207>,
	<209 208>,
	<210 209>,
	<211 210>,
	<212 211>,
	<213 212>,
	<214 213>,
	<215 214>,
	<216 215>,
	<217 216>,
	<218 217>,
	<219 218>,
	<220 219>,
	<221 220>,
	<222 221>,
	<223 222>,
	<224 223>,
	<225 224>,
	<226 225>,
	<227 226>,
	<228 227>,
	<229 228>,
	<230 229>,
	<231 230>,
	<232 231>,
	<233 232>,
	<234 233>,
	<235 234>,
	<236 235>,
	<237 236>,
	<238 237>,
	<239 238>,
	<240 239>,
	<241 240>,
	<242 241>,
	<243 242>,
	<244 243>,
	<245 244>,
	<246 245>,
	<247 246>,
	<248 247>,
	<249 248>,
	<250 249>,
	<251 250>,
	<252 251>,
	<253 252>,
	<254 253>,//-
	<255 255>;
};


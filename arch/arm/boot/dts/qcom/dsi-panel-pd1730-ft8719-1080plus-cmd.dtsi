/* Copyright (c) 2013, The Linux Foundation. All rights reserved.
 *
 * This program is free software; you can redistribute it and/or modify
 * it under the terms of the GNU General Public License version 2 and
 * only version 2 as published by the Free Software Foundation.
 *
 * This program is distributed in the hope that it will be useful,
 * but WITHOUT ANY WARRANTY; without even the implied warranty of
 * MERCHANTABILITY or FITNESS FOR A PARTICULAR PURPOSE.  See the
 * GNU General Public License for more details.
 */

/*---------------------------------------------------------------------------
 * This file is autogenerated file using gcdb parser. Please do not edit it.
 * Update input XML file to add a new entry or update variable in this file
 * VERSION = "1.0"
 *---------------------------------------------------------------------------*/
&mdss_mdp {
	dsi_pd1730_ft8719_1080plus_cmd: qcom,mdss_dsi_pd1730_ft8719_1080plus_cmd {
		qcom,mdss-dsi-panel-name = "mdss_dsi_pd1730_ft8719_1080plus_cmd panel";
		qcom,mdss-dsi-panel-controller = <&mdss_dsi0>;
		qcom,mdss-dsi-panel-type = "dsi_video_mode";
		qcom,mdss-dsi-project-name = "pd1730";
		qcom,mdss-dsi-panel-destination = "display_1";
		qcom,mdss-dsi-panel-framerate = <60>;
		//qcom,mdss-dsi-panel-clk-mipi-max = <996605504>; //type:966605504, max:
		//qcom,mdss-dsi-panel-clockrate =<655000000>;
		qcom,mdss-dsi-virtual-channel-id = <0>;
		qcom,mdss-dsi-stream = <0>;
		qcom,mdss-dsi-panel-id = <0x31>;
		qcom,mdss-dsi-panel-width = <1080>;
		qcom,mdss-dsi-panel-height = <2280>;
		qcom,mdss-dsi-h-front-porch = <30>;////16
		qcom,mdss-dsi-h-back-porch = <30>;////25
		qcom,mdss-dsi-h-pulse-width = <4>;////4
		qcom,mdss-dsi-h-sync-skew = <0>;
		qcom,mdss-dsi-v-front-porch = <115>;////190
		qcom,mdss-dsi-v-back-porch = <12>;
		qcom,mdss-dsi-v-pulse-width = <4>;

		qcom,mdss-dsi-h-front-porch-russia = <105>;////16
		qcom,mdss-dsi-h-back-porch-russia = <124>;////25
		//qcom,mdss-dsi-h-pulse-width = <14>;////4
		//qcom,mdss-dsi-h-sync-skew = <0>;
		qcom,mdss-dsi-v-front-porch-russia = <190>;////190
		qcom,mdss-dsi-v-back-porch-russia = <37>;
		//qcom,mdss-dsi-v-pulse-width = <8>;

		qcom,mdss-dsi-h-left-border = <0>;
		qcom,mdss-dsi-h-right-border = <0>;
		qcom,mdss-dsi-v-top-border = <0>;
		qcom,mdss-dsi-v-bottom-border = <0>;
		qcom,mdss-dsi-bpp = <24>;
		qcom,mdss-dsi-underflow-color = <0x00>;
		qcom,mdss-dsi-border-color = <0>;
		qcom,mdss-dsi-pixel-packing = "tight";
		qcom,mdss-dsi-on-command = [
29 01 00 00 00 00 02 00 00
29 01 00 00 00 00 04 ff 87 19 01
29 01 00 00 00 00 02 00 80
29 01 00 00 00 00 03 ff 87 19
29 01 00 00 00 00 02 00 a1
29 01 00 00 00 00 05 b3 04 38 08 e8
29 01 00 00 00 00 02 00 a5
29 01 00 00 00 00 02 b3 c0
29 01 00 00 00 00 02 00 a6
29 01 00 00 00 00 02 b3 f8
29 01 00 00 00 00 02 00 85
29 01 00 00 00 00 02 a7 03
29 01 00 00 00 00 02 00 d0
29 01 00 00 00 00 02 c3 46
29 01 00 00 00 00 02 00 d3
29 01 00 00 00 00 02 c3 30
29 01 00 00 00 00 02 00 d4
29 01 00 00 00 00 02 c3 46
29 01 00 00 00 00 02 00 d7
29 01 00 00 00 00 02 c3 30
29 01 00 00 00 00 02 00 ca
29 01 00 00 00 00 02 c0 80
29 01 00 00 00 00 02 00 80
29 01 00 00 00 00 11 c2 83 01 01 81 82 01 01 81 82 00 01 81 81 00 01 81
29 01 00 00 00 00 02 00 90
29 01 00 00 00 00 11 c2 80 00 01 81 01 00 01 81 02 00 01 81 03 00 01 81
29 01 00 00 00 00 02 00 a0
29 01 00 00 00 00 10 c2 8a 0a 00 01 8a 89 0a 00 01 8a 88 0a 00 01 8a
29 01 00 00 00 00 02 00 b0
29 01 00 00 00 00 10 c2 87 0a 00 01 8a 00 00 00 01 81 00 00 00 01 81
29 01 00 00 00 00 02 00 c0
29 01 00 00 00 00 10 c2 00 00 00 01 81 00 00 00 01 81 00 00 00 01 81
29 01 00 00 00 00 02 00 d0
29 01 00 00 00 00 10 c2 00 00 00 01 81 00 00 00 01 81 00 00 00 01 81
29 01 00 00 00 00 02 00 e0
29 01 00 00 00 00 0f c2 33 33 33 33 33 33 00 00 12 00 0a 0b 01 81
29 01 00 00 00 00 02 00 f0
29 01 00 00 00 00 0f c2 80 00 50 05 11 80 00 50 05 11 ff ff ff 01
29 01 00 00 00 00 02 00 80
29 01 00 00 00 00 11 cb fd fd fc 01 fd 01 01 fd fe 01 fd 01 fd fd 01 01
29 01 00 00 00 00 02 00 90
29 01 00 00 00 00 11 cb ff 00 00 00 00 00 00 00 ff 00 00 00 00 00 00 00
29 01 00 00 00 00 02 00 a0
29 01 00 00 00 00 05 cb 00 00 00 00
29 01 00 00 00 00 02 00 b0
29 01 00 00 00 00 05 cb 51 55 95 55
29 01 00 00 00 00 02 00 e0
29 01 00 00 00 00 02 c3 35
29 01 00 00 00 00 02 00 e4
29 01 00 00 00 00 02 c3 35
29 01 00 00 00 00 02 00 80
29 01 00 00 00 00 11 cc 00 00 00 00 00 00 00 00 00 29 24 04 04 18 17 16
29 01 00 00 00 00 02 00 90
29 01 00 00 00 00 09 cc 07 09 01 25 25 22 24 03
29 01 00 00 00 00 02 00 80
29 01 00 00 00 00 11 cd 00 00 00 00 00 00 00 00 00 29 24 04 04 18 17 16
29 01 00 00 00 00 02 00 90
29 01 00 00 00 00 09 cd 06 08 01 25 25 22 24 02
29 01 00 00 00 00 02 00 a0
29 01 00 00 00 00 11 cc 00 00 00 00 00 00 00 00 00 29 24 04 04 18 17 16
29 01 00 00 00 00 02 00 b0
29 01 00 00 00 00 09 cc 08 06 01 25 25 24 23 02
29 01 00 00 00 00 02 00 a0
29 01 00 00 00 00 11 cd 00 00 00 00 00 00 00 00 00 29 24 04 04 18 17 16
29 01 00 00 00 00 02 00 b0
29 01 00 00 00 00 09 cd 09 07 01 25 25 24 23 03
29 01 00 00 00 00 02 00 80
29 01 00 00 00 00 07 c0 00 7f 00 78 00 10
29 01 00 00 00 00 02 00 87
29 01 00 00 00 00 03 c0 01 01
29 01 00 00 00 00 02 00 8a
29 01 00 00 00 00 03 c0 1d 08
29 01 00 00 00 00 02 00 90
29 01 00 00 00 00 07 c0 00 78 00 b4 00 10
29 01 00 00 00 00 02 00 a0
29 01 00 00 00 00 07 c0 01 12 00 78 00 10
29 01 00 00 00 00 02 00 d7
29 01 00 00 00 00 07 c0 00 7a 00 78 00 10
29 01 00 00 00 00 02 00 b0
29 01 00 00 00 00 06 c0 00 7f 01 de 10
29 01 00 00 00 00 02 00 c1
29 01 00 00 00 00 09 c0 00 b7 00 90 00 7a 00 d8
29 01 00 00 00 00 02 00 a5
29 01 00 00 00 00 05 c1 00 24 00 02
29 01 00 00 00 00 02 00 80
29 01 00 00 00 00 10 ce 01 80 01 09 00 d0 00 d0 00 8a 00 8a 0d 0e 09
29 01 00 00 00 00 02 00 90
29 01 00 00 00 00 0b ce 00 82 0d 5c 00 82 80 09 00 04
29 01 00 00 00 00 02 00 a0
29 01 00 00 00 00 04 ce 00 00 00
29 01 00 00 00 00 02 00 b0
29 01 00 00 00 00 04 ce 11 00 00
29 01 00 00 00 00 02 00 c0
29 01 00 00 00 00 04 ce 00 00 00
29 01 00 00 00 00 02 00 d0
29 01 00 00 00 00 09 ce 91 00 0a 01 01 00 5d 01
29 01 00 00 00 00 02 00 e0
29 01 00 00 00 00 0d ce 88 08 02 15 02 15 02 15 00 2b 00 60
29 01 00 00 00 00 02 00 f0
29 01 00 00 00 00 0b ce 80 15 0a 0f 01 32 01 c6 00 ad
29 01 00 00 00 00 02 00 82
29 01 00 00 00 00 02 cf 06
29 01 00 00 00 00 02 00 84
29 01 00 00 00 00 02 cf 06
29 01 00 00 00 00 02 00 87
29 01 00 00 00 00 02 cf 06
29 01 00 00 00 00 02 00 89
29 01 00 00 00 00 02 cf 06
29 01 00 00 00 00 02 00 8a
29 01 00 00 00 00 02 cf 07
29 01 00 00 00 00 02 00 8b
29 01 00 00 00 00 02 cf 00
29 01 00 00 00 00 02 00 8c
29 01 00 00 00 00 02 cf 06
29 01 00 00 00 00 02 00 92
29 01 00 00 00 00 02 cf 06
29 01 00 00 00 00 02 00 94
29 01 00 00 00 00 02 cf 06
29 01 00 00 00 00 02 00 97
29 01 00 00 00 00 02 cf 06
29 01 00 00 00 00 02 00 99
29 01 00 00 00 00 02 cf 06
29 01 00 00 00 00 02 00 9a
29 01 00 00 00 00 02 cf 07
29 01 00 00 00 00 02 00 9b
29 01 00 00 00 00 02 cf 00
29 01 00 00 00 00 02 00 9c
29 01 00 00 00 00 02 cf 06
29 01 00 00 00 00 02 00 a0
29 01 00 00 00 00 02 cf 24
29 01 00 00 00 00 02 00 a2
29 01 00 00 00 00 02 cf 06
29 01 00 00 00 00 02 00 a4
29 01 00 00 00 00 02 cf 06
29 01 00 00 00 00 02 00 a7
29 01 00 00 00 00 02 cf 06
29 01 00 00 00 00 02 00 a9
29 01 00 00 00 00 02 cf 06
29 01 00 00 00 00 02 00 b0
29 01 00 00 00 00 0a cf 00 00 68 6c 00 04 04 78 7c
29 01 00 00 00 00 02 00 c0
29 01 00 00 00 00 0a cf 08 08 84 88 00 00 00 08 0c
29 01 00 00 00 00 02 00 83
29 01 00 00 00 00 02 a4 22
29 01 00 00 00 00 02 00 87
29 01 00 00 00 00 02 a4 0f
29 01 00 00 00 00 02 00 89
29 01 00 00 00 00 02 a4 0f
29 01 00 00 00 00 02 00 8d
29 01 00 00 00 00 02 a4 0f
29 01 00 00 00 00 02 00 8f
29 01 00 00 00 00 02 a4 0f
29 01 00 00 00 00 02 00 85
29 01 00 00 00 00 02 a7 00
29 01 00 00 00 00 02 00 e8
29 01 00 00 00 00 02 c0 40
29 01 00 00 00 00 02 00 85
29 01 00 00 00 00 02 c4 1e
29 01 00 00 00 00 02 00 00
29 01 00 00 00 00 29 e1 00 03 07 0e 34 19 22 29 34 58 3b 41 47 4c a7 51 59 60 67 19 6e 75 7c 84 4b 8e 94 9a a1 49 aa b4 c2 cb 28 d7 e9 f8 ff a3
29 01 00 00 00 00 02 00 00
29 01 00 00 00 00 29 e2 00 03 07 0e 34 19 22 29 34 58 3b 41 47 4c a7 51 59 60 67 19 6e 75 7c 84 4b 8e 94 9a a1 49 aa b4 c2 cb 28 d7 e9 f8 ff a3
29 01 00 00 00 00 02 00 00
29 01 00 00 00 00 29 e3 00 03 07 0e 34 19 22 29 34 58 3b 41 47 4c a7 51 59 60 67 19 6e 75 7c 84 4b 8e 94 9a a1 49 aa b4 c2 cb 28 d7 e9 f8 ff a3
29 01 00 00 00 00 02 00 00
29 01 00 00 00 00 29 e4 00 03 07 0e 34 19 22 29 34 58 3b 41 47 4c a7 51 59 60 67 19 6e 75 7c 84 4b 8e 94 9a a1 49 aa b4 c2 cb 28 d7 e9 f8 ff a3
29 01 00 00 00 00 02 00 00
29 01 00 00 00 00 29 e5 00 03 07 0e 34 19 22 29 34 58 3b 41 47 4c a7 51 59 60 67 19 6e 75 7c 84 4b 8e 94 9a a1 49 aa b4 c2 cb 28 d7 e9 f8 ff a3
29 01 00 00 00 00 02 00 00
29 01 00 00 00 00 29 e6 00 03 07 0e 34 19 22 29 34 58 3b 41 47 4c a7 51 59 60 67 19 6e 75 7c 84 4b 8e 94 9a a1 49 aa b4 c2 cb 28 d7 e9 f8 ff a3
29 01 00 00 00 00 02 00 82
29 01 00 00 00 00 03 c5 50 50
29 01 00 00 00 00 02 00 84
29 01 00 00 00 00 04 c5 32 32 00
29 01 00 00 00 00 02 00 87
29 01 00 00 00 00 03 c5 60 0c 
29 01 00 00 00 00 02 00 00
29 01 00 00 00 00 03 d8 23 23
29 01 00 00 00 00 02 00 00
29 01 00 00 00 00 04 d9 00 91 91
29 01 00 00 00 00 02 00 a3
29 01 00 00 00 00 02 c5 19
29 01 00 00 00 00 02 00 a9
29 01 00 00 00 00 02 c5 23
29 01 00 00 00 00 02 00 80
29 01 00 00 00 00 02 a4 70
29 01 00 00 00 00 02 00 80
29 01 00 00 00 00 03 c5 86 86
29 01 00 00 00 00 02 00 80
29 01 00 00 00 00 02 a7 03
29 01 00 00 00 00 02 00 8c
29 01 00 00 00 00 04 c3 03 00 30
29 01 00 00 00 00 02 00 b0
29 01 00 00 00 00 02 f5 00
29 01 00 00 00 00 02 00 b0
29 01 00 00 00 00 03 f3 07 f8
//39 01 00 00 00 00 02 51 FF
39 01 00 00 00 00 02 53 24
39 01 00 00 00 00 02 35 00

29 01 00 00 00 00 02 00 80
29 01 00 00 00 00 0d ca a2 9b 94 8e 89 84 81 80 80 80 80 80
29 01 00 00 00 00 02 00 90
29 01 00 00 00 00 0a ca fb ff 5b f7 ff 84 f6 ff 66
//39 01 00 00 00 00 03 51 ff 0f
39 01 00 00 00 00 02 53 2c
39 01 00 00 00 00 02 55 01

05 01 00 00 78 00 02 11 00
05 01 00 00 00 00 02 29 00
		];
		qcom,mdss-dsi-on-cabc-levle1 = [
29 01 00 00 00 00 03 50 5A 23
//29 01 00 00 00 00 03 90 ff 0f
29 01 00 00 00 00 03 94 2C 01
29 01 00 00 00 00 03 50 00 2F
		];

		qcom,mdss-dsi-on-cabc-levle2 = [
29 01 00 00 00 00 03 50 5A 23
//29 01 00 00 00 00 03 90 ff 0f
29 01 00 00 00 00 03 94 2C 02
29 01 00 00 00 00 03 50 00 2F
		];

		qcom,mdss-dsi-on-cabc-levle3 = [
29 01 00 00 00 00 03 50 5A 23
//29 01 00 00 00 00 03 90 ff 0f
29 01 00 00 00 00 03 94 2C 03
29 01 00 00 00 00 03 50 00 2F
		];
		qcom,mdss-dsi-on-cabc-off = [
29 01 00 00 00 00 03 50 5A 23
//29 01 00 00 00 00 03 90 ff 0f
29 01 00 00 00 00 03 94 2c 00
29 01 00 00 00 00 03 50 00 2F
		];
		qcom,mdss-dsi-off-command = [

					39 01 00 00 32 00 02 28 00
					39 01 00 00 32 00 02 10 00
					/*39 01 00 00 00 00 02 04 5A
					39 01 00 00 00 00 02 05 5A*/
					];
		qcom,mdss-dsi-on-command-state = "dsi_lp_mode";
		qcom,mdss-dsi-off-command-state = "dsi_lp_mode";
		qcom,mdss-dsi-h-sync-pulse = <1>;
		qcom,mdss-dsi-traffic-mode = "non_burst_sync_event";
		qcom,mdss-dsi-bllp-eof-power-mode;
		qcom,mdss-dsi-bllp-power-mode;
		//qcom,mdss-dsi-hbp-power-mode;
		qcom,mdss-dsi-tx-eot-append;
		qcom,mdss-dsi-lane-0-state;
		qcom,mdss-dsi-lane-1-state;
		qcom,mdss-dsi-lane-2-state;
		qcom,mdss-dsi-lane-3-state;
		qcom,mdss-dsi-lp11-init;
		qcom,mdss-dsi-init-delay-us = <15000>;
		//qcom,mdss-dsi-panel-timings = [88 1C 12 00 42 44 18 20 16 03 04 00];

		qcom,mdss-dsi-panel-timings-phy-v2 = [
		21 1d 06 07 04 03 04 a0
		21 1d 06 07 04 03 04 a0
		21 1d 06 07 04 03 04 a0
		21 1d 06 07 04 03 04 a0
		21 14 06 07 04 03 04 a0];
		qcom,mdss-dsi-t-clk-post = <0x0C>;
		qcom,mdss-dsi-t-clk-pre = <0x27>;//0x1B

		qcom,mdss-dsi-panel-russia-timings-phy-v2 = [
		22 1E 07 08 04 03 04 a0
		22 1E 07 08 04 03 04 a0
		22 1E 07 08 04 03 04 a0
		22 1E 07 08 04 03 04 a0
		22 17 07 08 04 03 04 a0];
		qcom,mdss-dsi-t-clk-post-russia = <0x0C>;
		qcom,mdss-dsi-t-clk-pre-russia = <0x2B>;

		qcom,mdss-dsi-bl-min-level = <1>;
		qcom,mdss-dsi-bl-max-level = <2047>;
		/*qcom,panel-supply-entries = <&dsi_panel_pwr_supply>;*/
		qcom,mdss-dsi-dma-trigger = "trigger_sw";
		qcom,mdss-dsi-mdp-trigger = "none";
		qcom,mdss-dsi-bl-pmic-control-type = "bl_i2c";
		qcom,mdss-dsi-reset-sequence = <1 5>, <0 5>, <1 20>;
		qcom,mdss-pan-physical-width-dimension = <68>;////68.04
		qcom,mdss-pan-physical-height-dimension = <144>;////143.64 from wuhan 1208
		qcom,suspend-ulps-enabled;

		//ESD  read register check
		//qcom,esd-check-enabled;
		qcom,mdss-dsi-panel-status-command = [06 01 00 01 05 00 02 0A 08
		06 01 00 01 05 00 02 0C 08
		06 01 00 01 05 00 02 0D 08
		06 01 00 01 05 00 02 0E 08];
		qcom,mdss-dsi-panel-status-command-state = "dsi_hs_mode";
		qcom,mdss-dsi-panel-status-check-mode = "reg_read";
		qcom,mdss-dsi-panel-status-value = <0x9C>,<0x07>,<0x00>,<0x80>;
		//qcom,mdss-dsi-panel-status-value = <0x9C>;
		qcom,mdss-dsi-panel-status-read-length = <1 1 1 1>;
		//qcom,mdss-dsi-panel-status-read-length = <1>;
		qcom,mdss-dsi-panel-max-error-count = <5>;

	};
};

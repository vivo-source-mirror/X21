/* Copyright (c) 2016-2017, The Linux Foundation. All rights reserved.
 *
 * This program is free software; you can redistribute it and/or modify
 * it under the terms of the GNU General Public License version 2 and
 * only version 2 as published by the Free Software Foundation.
 *
 * This program is distributed in the hope that it will be useful,
 * but WITHOUT ANY WARRANTY; without even the implied warranty of
 * MERCHANTABILITY or FITNESS FOR A PARTICULAR PURPOSE.  See the
 * GNU General Public License for more details.
 */

/* first */
qcom,bbk_pd1814_atl_3400mah_first {
	/* #3549776_BBK_BF0_3400mAh_averaged_MasterSlave_Jun29th2018*/
	qcom,max-voltage-uv = <4380000>;
	qcom,nom-batt-capacity-mah = <3330>;
	qcom,batt-id-kohm = <100>;
	qcom,battery-beta = <3380>;
	qcom,fg-cc-cv-threshold-mv = <4370>;
	qcom,battery-type = "bbk_pd1814_atl(nv)_3400mah_first";
	qcom,checksum = <0xF5D0>;
	qcom,gui-version = "PM660GUI - 0.0.0.45";
	qcom,fg-profile-data = [
		 EA 1F 36 05
		 C8 0A FE 05
		 E7 1C D0 01
		 2A 04 31 0A
		 17 18 28 23
		 6D 45 E2 52
		 7D 00 00 00
		 13 00 00 00
		 00 00 FC D5
		 02 B4 E1 CB
		 22 00 08 00
		 30 00 8D ED
		 7A F4 77 00
		 FE 02 A0 12
		 6B FC 01 2B
		 19 06 09 20
		 27 00 14 00
		 4E 20 E4 04
		 05 0B BD 05
		 D2 1C A9 02
		 A7 0C 8E 0B
		 87 18 4A 23
		 F3 44 EC 53
		 74 00 00 00
		 10 00 00 00
		 00 00 B0 CC
		 3E CA 43 C5
		 20 00 00 00
		 67 EB 8D ED
		 5A 07 5D EA
		 53 E2 61 03
		 C9 05 25 13
		 99 33 CC FF
		 07 10 00 00
		 27 0D 14 46
		 20 00 40 00
		 2C 01 0A FA
		 FF 00 00 00
		 00 00 00 00
		 00 00 00 00
		 00 00 00 00
		 00 00 00 00
		 00 00 00 00
		 00 00 00 00
		 00 00 00 00
		 00 00 00 00
		 00 00 00 00
		 00 00 00 00
		 00 00 00 00
		 00 00 00 00
		 00 00 00 00
		 00 00 00 00
		 00 00 00 00
		 00 00 00 00
		 00 00 00 00
		 00 00 00 00
	];

	vivo,msoc-mapping-enable;
	vivo,msoc-mapping-col-legend = <2>;
	vivo,msoc-mapping-row-legend = <256>;
	vivo,msoc-mapping-data =
	<0 0>,
	<1 1>,
	<2 2>,
	<3 3>,
	<4 4>,
	<5 5>,
	<6 6>,
	<7 7>,//+
	<8 7>,
	<9 8>,
	<10 9>,
	<11 10>,
	<12 11>,
	<13 12>,
	<14 13>,
	<15 14>,
	<16 15>,//+
	<17 15>,
	<18 16>,
	<19 17>,
	<20 18>,
	<21 19>,
	<22 20>,
	<23 21>,
	<24 21>,//+
	<25 22>,
	<26 23>,
	<27 24>,
	<28 25>,
	<29 26>,
	<30 27>,
	<31 28>,
	<32 29>,
	<33 30>,
	<34 31>,
	<35 32>,
	<36 33>,
	<37 34>,
	<38 35>,
	<39 36>,
	<40 37>,
	<41 38>,
	<42 39>,
	<43 40>,
	<44 41>,
	<45 42>,
	<46 43>,
	<47 44>,
	<48 45>,
	<49 46>,
	<50 47>,
	<51 48>,
	<52 49>,
	<53 50>,
	<54 51>,
	<55 52>,
	<56 53>,
	<57 54>,
	<58 55>,
	<59 56>,
	<60 57>,
	<61 58>,
	<62 59>,
	<63 60>,
	<64 61>,
	<65 62>,
	<66 63>,
	<67 64>,
	<68 65>,
	<69 66>,
	<70 67>,
	<71 68>,
	<72 69>,
	<73 70>,
	<74 71>,
	<75 72>,
	<76 73>,
	<77 74>,
	<78 75>,
	<79 76>,
	<80 77>,
	<81 78>,
	<82 79>,
	<83 80>,
	<84 81>,
	<85 82>,
	<86 83>,
	<87 84>,
	<88 85>,
	<89 86>,
	<90 87>,
	<91 88>,
	<92 89>,
	<93 90>,
	<94 91>,
	<95 92>,
	<96 93>,
	<97 94>,
	<98 95>,
	<99 96>,
	<100 97>,
	<101 98>,
	<102 99>,
	<103 100>,
	<104 101>,
	<105 102>,
	<106 103>,
	<107 104>,
	<108 105>,
	<109 106>,
	<110 107>,
	<111 108>,
	<112 109>,
	<113 110>,
	<114 111>,
	<115 112>,
	<116 113>,//-
	<117 115>,
	<118 116>,
	<119 117>,
	<120 118>,
	<121 119>,
	<122 120>,
	<123 121>,
	<124 122>,
	<125 123>,
	<126 124>,
	<127 125>,
	<128 126>,
	<129 127>,
	<130 128>,
	<131 129>,
	<132 130>,
	<133 131>,
	<134 132>,
	<135 133>,
	<136 134>,
	<137 135>,
	<138 136>,
	<139 137>,
	<140 138>,//-
	<141 140>,
	<142 141>,
	<143 142>,
	<144 143>,
	<145 144>,
	<146 145>,
	<147 146>,
	<148 147>,
	<149 148>,
	<150 149>,
	<151 150>,
	<152 151>,
	<153 152>,
	<154 153>,
	<155 154>,
	<156 155>,
	<157 156>,
	<158 157>,
	<159 158>,
	<160 159>,
	<161 160>,
	<162 161>,
	<163 162>,
	<164 163>,
	<165 164>,
	<166 165>,
	<167 166>,
	<168 167>,
	<169 168>,
	<170 169>,
	<171 170>,
	<172 171>,
	<173 172>,
	<174 173>,
	<175 174>,
	<176 175>,
	<177 176>,
	<178 177>,
	<179 178>,
	<180 179>,
	<181 180>,
	<182 181>,
	<183 182>,
	<184 183>,
	<185 184>,
	<186 185>,
	<187 186>,
	<188 187>,
	<189 188>,
	<190 189>,
	<191 190>,
	<192 191>,
	<193 192>,
	<194 193>,
	<195 194>,
	<196 195>,
	<197 196>,
	<198 197>,
	<199 198>,
	<200 199>,
	<201 200>,
	<202 201>,
	<203 202>,
	<204 203>,
	<205 204>,
	<206 205>,
	<207 206>,
	<208 207>,
	<209 208>,
	<210 209>,
	<211 210>,
	<212 211>,
	<213 212>,
	<214 213>,
	<215 214>,
	<216 215>,
	<217 216>,
	<218 217>,
	<219 218>,
	<220 219>,
	<221 220>,
	<222 221>,
	<223 222>,
	<224 223>,
	<225 224>,
	<226 225>,
	<227 226>,
	<228 227>,
	<229 228>,
	<230 229>,
	<231 230>,
	<232 231>,
	<233 232>,
	<234 233>,
	<235 234>,
	<236 235>,
	<237 236>,
	<238 237>,
	<239 238>,
	<240 239>,
	<241 240>,
	<242 241>,
	<243 242>,
	<244 243>,
	<245 244>,
	<246 245>,
	<247 246>,
	<248 247>,
	<249 248>,
	<250 249>,
	<251 250>,
	<252 251>,
	<253 252>,
	<254 253>,//-
	<255 255>;
};


/* Copyright (c) 2013, The Linux Foundation. All rights reserved.
 *
 * This program is free software; you can redistribute it and/or modify
 * it under the terms of the GNU General Public License version 2 and
 * only version 2 as published by the Free Software Foundation.
 *
 * This program is distributed in the hope that it will be useful,
 * but WITHOUT ANY WARRANTY; without even the implied warranty of
 * MERCHANTABILITY or FITNESS FOR A PARTICULAR PURPOSE.  See the
 * GNU General Public License for more details.
 */

/*---------------------------------------------------------------------------
 * This file is autogenerated file using gcdb parser. Please do not edit it.
 * Update input XML file to add a new entry or update variable in this file
 * VERSION = "1.0"
 *---------------------------------------------------------------------------*/
&mdss_mdp {
	dsi_pd1730_tianma_ft8719_1080plus_video: qcom,mdss_dsi_pd1730_tianma_ft8719_1080plus_video {
		qcom,mdss-dsi-panel-name = "mdss_dsi_pd1730_tianma_ft8719_1080plus_video panel";
		qcom,mdss-dsi-panel-controller = <&mdss_dsi0>;
		qcom,mdss-dsi-panel-type = "dsi_video_mode";
		qcom,mdss-dsi-project-name = "pd1730";
		qcom,mdss-dsi-panel-destination = "display_1";
		qcom,mdss-dsi-panel-framerate = <60>;
		//qcom,mdss-dsi-panel-clk-mipi-max = <996605504>; //type:966605504, max:
		//qcom,mdss-dsi-panel-clockrate =<655000000>;
		qcom,mdss-dsi-virtual-channel-id = <0>;
		qcom,mdss-dsi-stream = <0>;
		qcom,mdss-dsi-panel-id = <0x11>;
		qcom,mdss-dsi-panel-width = <1080>;
		qcom,mdss-dsi-panel-height = <2280>;
		qcom,mdss-dsi-h-front-porch = <16>;
		qcom,mdss-dsi-h-back-porch = <16>;
		qcom,mdss-dsi-h-pulse-width = <4>;
		qcom,mdss-dsi-h-sync-skew = <0>;
		qcom,mdss-dsi-v-front-porch = <120>;
		qcom,mdss-dsi-v-back-porch = <12>;
		qcom,mdss-dsi-v-pulse-width = <4>;

		qcom,mdss-dsi-h-left-border = <0>;
		qcom,mdss-dsi-h-right-border = <0>;
		qcom,mdss-dsi-v-top-border = <0>;
		qcom,mdss-dsi-v-bottom-border = <0>;
		qcom,mdss-dsi-bpp = <24>;
		qcom,mdss-dsi-underflow-color = <0x00>;
		qcom,mdss-dsi-border-color = <0>;
		qcom,mdss-dsi-pixel-packing = "tight";
		qcom,mdss-dsi-on-command = [
			39 01 00 00 00 00 02 00 00
			39 01 00 00 00 00 04 ff 87 19 01
			39 01 00 00 00 00 02 00 80
			39 01 00 00 00 00 03 ff 87 19
			
			/*29 01 00 00 00 00 02 00 83
			29 01 00 00 00 00 02 a4 23*/
			
			05 01 00 00 78 00 02 11 00
			39 01 00 00 00 00 02 00 80	//GAIN
			39 01 00 00 00 00 0d CA CA B8 A9 9D 95 8D 87 82 80 80 80 80

			39 01 00 00 00 00 02 00 90	//DUTY
			39 01 00 00 00 00 0a CA FC 06 AC DB C1 32 CA CC 65

			39 01 00 00 00 00 02 00 b5	//PWM DIM
			39 01 00 00 00 00 02 ca 08

			39 01 00 00 00 00 02 00 A0	//CABC DIM
			39 01 00 00 00 00 02 CA 08

			39 01 00 00 00 00 02 51 ff
			39 01 00 00 00 00 02 53 24
			39 01 00 00 00 00 02 55 00
			05 01 00 00 14 00 02 29 00
		];
		qcom,mdss-dsi-on-cabc-levle1 = [
			29 01 00 00 00 00 03 50 5A 23
			29 01 00 00 00 00 03 94 2C 01
			29 01 00 00 00 00 03 50 00 2F
		];

		qcom,mdss-dsi-on-cabc-levle2 = [
			29 01 00 00 00 00 03 50 5A 23
			29 01 00 00 00 00 03 94 2C 02
			29 01 00 00 00 00 03 50 00 2F
		];

		qcom,mdss-dsi-on-cabc-levle3 = [
			29 01 00 00 00 00 03 50 5A 23
			29 01 00 00 00 00 03 94 2C 03
			29 01 00 00 00 00 03 50 00 2F
		];
		qcom,mdss-dsi-on-cabc-off = [
			29 01 00 00 00 00 03 50 5A 23
			29 01 00 00 00 00 03 94 2c 00
			29 01 00 00 00 00 03 50 00 2F
		];
		qcom,mdss-dsi-off-command = [
			39 01 00 00 32 00 02 28 00
			39 01 00 00 32 00 02 10 00
		];
		qcom,mdss-dsi-on-command-state = "dsi_lp_mode";
		qcom,mdss-dsi-off-command-state = "dsi_lp_mode";
		qcom,mdss-dsi-h-sync-pulse = <1>;
		qcom,mdss-dsi-traffic-mode = "non_burst_sync_event";
		qcom,mdss-dsi-bllp-eof-power-mode;
		qcom,mdss-dsi-bllp-power-mode;
		//qcom,mdss-dsi-hbp-power-mode;
		qcom,mdss-dsi-tx-eot-append;
		qcom,mdss-dsi-lane-0-state;
		qcom,mdss-dsi-lane-1-state;
		qcom,mdss-dsi-lane-2-state;
		qcom,mdss-dsi-lane-3-state;
		qcom,mdss-dsi-lp11-init;
		qcom,mdss-dsi-init-delay-us = <15000>;
		//qcom,mdss-dsi-panel-timings = [88 1C 12 00 42 44 18 20 16 03 04 00];

		qcom,mdss-dsi-panel-timings-phy-v2 = [
			25 1f 09 0a 06 03 04 a0
			25 1f 09 0a 06 03 04 a0
			25 1f 09 0a 06 03 04 a0
			25 1f 09 0a 06 03 04 a0
			25 1d 08 0a 06 03 04 a0
		];
		qcom,mdss-dsi-t-clk-post = <0x0C>;
		qcom,mdss-dsi-t-clk-pre = <0x27>;//0x1B
		qcom,mdss-dsi-bl-min-level = <1>;
		qcom,mdss-dsi-bl-max-level = <2047>;
		/*qcom,panel-supply-entries = <&dsi_panel_pwr_supply>;*/
		qcom,mdss-dsi-dma-trigger = "trigger_sw";
		qcom,mdss-dsi-mdp-trigger = "none";
		qcom,mdss-dsi-bl-pmic-control-type = "bl_i2c";
		qcom,mdss-dsi-reset-sequence = <1 5>, <0 5>, <1 20>;
		qcom,mdss-pan-physical-width-dimension = <68>;////68.04
		qcom,mdss-pan-physical-height-dimension = <144>;////143.64 from wuhan 1208
		qcom,suspend-ulps-enabled;

		//ESD  read register check
		//qcom,esd-check-enabled;
		qcom,mdss-dsi-panel-status-command = [06 01 00 01 05 00 02 0A 08
		06 01 00 01 05 00 02 0C 08
		06 01 00 01 05 00 02 0D 08
		06 01 00 01 05 00 02 0E 08];
		qcom,mdss-dsi-panel-status-command-state = "dsi_hs_mode";
		qcom,mdss-dsi-panel-status-check-mode = "reg_read";
		qcom,mdss-dsi-panel-status-value = <0x9C>,<0x07>,<0x00>,<0x80>;
		//qcom,mdss-dsi-panel-status-value = <0x9C>;
		qcom,mdss-dsi-panel-status-read-length = <1 1 1 1>;
		//qcom,mdss-dsi-panel-status-read-length = <1>;
		qcom,mdss-dsi-panel-max-error-count = <5>;

	};
};

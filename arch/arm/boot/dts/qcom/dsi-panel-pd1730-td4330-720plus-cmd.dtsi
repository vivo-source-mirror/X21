/* Copyright (c) 2013, The Linux Foundation. All rights reserved.
 *
 * This program is free software; you can redistribute it and/or modify
 * it under the terms of the GNU General Public License version 2 and
 * only version 2 as published by the Free Software Foundation.
 *
 * This program is distributed in the hope that it will be useful,
 * but WITHOUT ANY WARRANTY; without even the implied warranty of
 * MERCHANTABILITY or FITNESS FOR A PARTICULAR PURPOSE.  See the
 * GNU General Public License for more details.
 */

/*---------------------------------------------------------------------------
 * This file is autogenerated file using gcdb parser. Please do not edit it.
 * Update input XML file to add a new entry or update variable in this file
 * VERSION = "1.0"
 *---------------------------------------------------------------------------*/
&mdss_mdp {
	dsi_pd1730_td4330_1080plus_cmd: qcom,mdss_dsi_pd1730_td4330_1080plus_cmd {
		qcom,mdss-dsi-panel-name = "mdss_dsi_pd1730_td4330_1080plus_cmd panel";
		qcom,mdss-dsi-panel-controller = <&mdss_dsi0>;
		qcom,mdss-dsi-panel-type = "dsi_cmd_mode";
		qcom,mdss-dsi-project-name = "pd1730";
		qcom,mdss-dsi-panel-destination = "display_1";
		qcom,mdss-dsi-panel-framerate = <60>;
		//qcom,mdss-dsi-panel-clk-mipi-max = <996605504>; //type:966605504, max:
		//qcom,mdss-dsi-panel-clockrate =<655000000>;
		qcom,mdss-dsi-virtual-channel-id = <0>;
		qcom,mdss-dsi-stream = <0>;
		qcom,mdss-dsi-panel-id = <0x30>;
		qcom,mdss-dsi-panel-width = <1080>;
		qcom,mdss-dsi-panel-height = <2280>;

		qcom,mdss-dsi-h-front-porch = <100>;
		qcom,mdss-dsi-h-back-porch = <82>;/*modify mipi clk to 578.6MHz*/
		qcom,mdss-dsi-h-pulse-width = <3>;
		qcom,mdss-dsi-h-sync-skew = <0>;
		qcom,mdss-dsi-v-front-porch = <160>;
		qcom,mdss-dsi-v-back-porch = <100>;
		qcom,mdss-dsi-v-pulse-width = <3>;

		/*qcom,mdss-dsi-h-front-porch = <40>;////16
		qcom,mdss-dsi-h-back-porch = <40>;////25
		qcom,mdss-dsi-h-pulse-width = <2>;////4
		qcom,mdss-dsi-h-sync-skew = <0>;
		qcom,mdss-dsi-v-front-porch = <12>;////190
		qcom,mdss-dsi-v-back-porch = <12>;
		qcom,mdss-dsi-v-pulse-width = <2>;*/

		qcom,mdss-dsi-h-front-porch-russia = <105>;////16
		qcom,mdss-dsi-h-back-porch-russia = <124>;////25
		//qcom,mdss-dsi-h-pulse-width = <14>;////4
		//qcom,mdss-dsi-h-sync-skew = <0>;
		qcom,mdss-dsi-v-front-porch-russia = <190>;////190
		qcom,mdss-dsi-v-back-porch-russia = <37>;
		//qcom,mdss-dsi-v-pulse-width = <8>;

		qcom,mdss-dsi-h-left-border = <0>;
		qcom,mdss-dsi-h-right-border = <0>;
		qcom,mdss-dsi-v-top-border = <0>;
		qcom,mdss-dsi-v-bottom-border = <0>;
		qcom,mdss-dsi-bpp = <24>;
		qcom,mdss-dsi-underflow-color = <0x00>;
		qcom,mdss-dsi-border-color = <0>;
		qcom,mdss-dsi-pixel-packing = "tight";
		qcom,mdss-dsi-on-command = [
39 01 00 00 64 00 01 11
29 01 00 00 00 00 02 B0 00
29 01 00 00 00 00 0D B6 30 6B 00 06 03 0A 13 1A 6C 18 19 02
29 01 00 00 00 00 05 B7 00 00 00 00

/*29 01 00 00 00 00 08 B8 45 51 02 BC 26 02 06
29 01 00 00 00 00 08 B9 65 55 02 BC 27 01 06*//*0209 modify for CABC*/
29 01 00 00 00 00 08 B8 45 51 02 BC 00 08 08
29 01 00 00 00 00 08 B9 65 55 02 BC 27 01 06

29 01 00 00 00 00 08 BA B5 33 41 BE 64 23 0A
29 01 00 00 00 00 0C BB 44 26 C3 1F 19 06 03 C0 00 00 10
29 01 00 00 00 00 0C BC 32 4C C3 52 32 1F 03 F2 00 00 13
29 01 00 00 00 00 0C BD 24 68 C3 AA 3F 32 03 FF 00 00 25
29 01 00 00 00 00 0D BE 10 00 00 00 00 00 8D 80 00 00 00 00

/*39 01 00 00 00 00 24 CE 1D 40 49 53 59 5E 63 68 6E 74 7E 8A 98 A8 BB D0 E7 FF 04 00 04 04 42 40 69 5A 40 11 F4 00 00 04 FA 00 00*//*0209 modify for Diming _21th 22th cabc diming frames is 0x20*8=90S*/
39 01 00 00 00 00 24 CE 7D 40 49 53 59 5E 63 68 6E 74 7E 8A 98 A8 BB D0 E7 FF 04 00 20 20 42 40 69 5A 40 11 F4 00 00 04 FA 00 00/*0209 modify for Diming _21th 22th cabc diming frames is 0x20*8=90S*/

29 01 00 00 00 00 02 D6 C0/*OTP*//*c0*/

29 01 00 00 00 00 02 B0 03/*lock cmd*/

39 01 00 00 00 00 03 51 FF F0
39 01 00 00 00 00 02 53 24

39 01 00 00 00 00 02 55 00

29 01 00 00 00 00 02 35 01
39 01 00 00 00 00 05 2A 00 00 04 37
39 01 00 00 00 00 05 2B 00 00 08 E7

39 01 00 00 00 00 02 B0 00
39 01 00 00 00 00 1E EA 01 02 47 40 47 40 00 00 05 00 14 BB 00 00 00 00 00 00 00 00 04 C2 00 11 00 30 0D 50 86
39 01 00 00 00 00 21 ED 01 01 02 02 02 02 00 00 00 00 00 00 03 01 00 00 00 10 00 18 00 00 00 B0 00 14 8B 00 00 90 10 00

39 01 00 00 14 00 01 29
/*39 01 00 00 64 00 01 11*/
		];

		qcom,mdss-dsi-on-cabc-levle1 = [
29 01 00 00 00 00 03 50 5A 23
//29 01 00 00 00 00 03 90 ff 0f
29 01 00 00 00 00 03 94 2C 01
29 01 00 00 00 00 03 50 00 2F
		];

		qcom,mdss-dsi-on-cabc-levle2 = [
29 01 00 00 00 00 03 50 5A 23
//29 01 00 00 00 00 03 90 ff 0f
29 01 00 00 00 00 03 94 2C 02
29 01 00 00 00 00 03 50 00 2F
		];

		qcom,mdss-dsi-on-cabc-levle3 = [
29 01 00 00 00 00 03 50 5A 23
//29 01 00 00 00 00 03 90 ff 0f
29 01 00 00 00 00 03 94 2C 03
29 01 00 00 00 00 03 50 00 2F
		];
		qcom,mdss-dsi-on-cabc-off = [
29 01 00 00 00 00 03 50 5A 23
//29 01 00 00 00 00 03 90 ff 0f
29 01 00 00 00 00 03 94 2c 00
29 01 00 00 00 00 03 50 00 2F
		];
		qcom,mdss-dsi-off-command = [
					39 01 00 00 14 00 02 28 00/*to update a back picture,at least 16ms*/
					39 01 00 00 50 00 02 10 00/*reset down 70ms later than 0x10*/
					/*39 01 00 00 00 00 02 04 5A
					39 01 00 00 00 00 02 05 5A*/
					];

/*qcom,mdss-lcm-page-slect-command = [
29 01 00 00 00 00 06 F0 55 AA 52 08 01
];*/
/*from BOE liuhui 2018 0102 vgh 7.5 -- 8.5;vgl -8.5----   -7.5 ,but step is 0.2v */
/*
vgh max   8.4v    90
vgh min   7.6v    86
vgl max   -7.6v   C6
vgl min   -8.4v   D0
*/
qcom,mdss-lcm-vgh-max-vgl-max-type4-command = [/*type 4*/
29 01 00 00 00 00 02 B0 00
29 01 00 00 00 00 12 D0 F3 90 11 B1 55 CC 00 F3 c6 11 F0 01 12 CC 02 20 11
];

qcom,mdss-lcm-vgh-max-vgl-min-type3-command = [/*type 3*/
29 01 00 00 00 00 02 B0 00
29 01 00 00 00 00 12 D0 F3 90 11 B1 55 CC 00 F3 D0 11 F0 01 12 CC 02 20 11
];

qcom,mdss-lcm-vgh-min-vgl-max-type2-command = [/*type 2*/
29 01 00 00 00 00 02 B0 00
29 01 00 00 00 00 12 D0 F3 86 11 B1 55 CC 00 F3 c6 11 F0 01 12 CC 02 20 11
];

qcom,mdss-lcm-vgh-min-vgl-min-type1-command = [/*type 1*/
29 01 00 00 00 00 02 B0 00
29 01 00 00 00 00 12 D0 F3 86 11 B1 55 CC 00 F3 D0 11 F0 01 12 CC 02 20 11
];
/*add for lcm vgh vgl test end*/

		qcom,mdss-dsi-on-command-state = "dsi_lp_mode";
		qcom,mdss-dsi-off-command-state = "dsi_hs_mode";
		qcom,mdss-dsi-h-sync-pulse = <1>;
		qcom,mdss-dsi-traffic-mode = "non_burst_sync_event";
		qcom,mdss-dsi-bllp-eof-power-mode;
		qcom,mdss-dsi-bllp-power-mode;
		//qcom,mdss-dsi-hbp-power-mode;
		qcom,mdss-dsi-tx-eot-append;
		qcom,mdss-dsi-lane-0-state;
		qcom,mdss-dsi-lane-1-state;
		qcom,mdss-dsi-lane-2-state;
		qcom,mdss-dsi-lane-3-state;
		qcom,mdss-dsi-lp11-init;
		/*qcom,mdss-dsi-init-delay-us = <15000>;*/
		//qcom,mdss-dsi-panel-timings = [88 1C 12 00 42 44 18 20 16 03 04 00];
		qcom,mdss-dsi-te-pin-select = <1>;
		qcom,mdss-dsi-wr-mem-start = <0x2c>;
		qcom,mdss-dsi-te-dcs-command = <1>;
		qcom,mdss-dsi-te-check-enable;
		qcom,mdss-dsi-te-using-te-pin;

		/*qcom,mdss-dsi-panel-timings-phy-v2 = [
		25 20 08 0A 06 03 04 a0
		25 20 08 0A 06 03 04 a0
		25 20 08 0A 06 03 04 a0
		25 20 08 0A 06 03 04 a0
		25 1D 08 0A 06 03 04 a0];
		qcom,mdss-dsi-t-clk-post = <0x0C>;
		qcom,mdss-dsi-t-clk-pre = <0x27>;//0x1B*/

		qcom,mdss-dsi-panel-timings-phy-v2 = [/*for mipi clk 578.6MHz LRZ add 0114*/
		27 21 0A 0C 07 03 04 a0
		27 21 0A 0C 07 03 04 a0
		27 21 0A 0C 07 03 04 a0
		27 21 0A 0C 07 03 04 a0
		27 23 0A 0C 07 03 04 a0];
		qcom,mdss-dsi-t-clk-post = <0x0F>;
		qcom,mdss-dsi-t-clk-pre = <0x3A>;//0x1B

		qcom,mdss-dsi-panel-russia-timings-phy-v2 = [
		22 1E 07 08 04 03 04 a0
		22 1E 07 08 04 03 04 a0
		22 1E 07 08 04 03 04 a0
		22 1E 07 08 04 03 04 a0
		22 17 07 08 04 03 04 a0];
		qcom,mdss-dsi-t-clk-post-russia = <0x0C>;
		qcom,mdss-dsi-t-clk-pre-russia = <0x2B>;

		qcom,mdss-dsi-bl-min-level = <1>;
		qcom,mdss-dsi-bl-max-level = <2047>;
		/*qcom,panel-supply-entries = <&dsi_panel_pwr_supply>;*/
		qcom,mdss-dsi-dma-trigger = "trigger_sw";
		qcom,mdss-dsi-mdp-trigger = "none";
		qcom,mdss-dsi-bl-pmic-control-type = "bl_i2c";
		qcom,mdss-dsi-reset-sequence = <1 5>, <0 5>, <1 5>;
		qcom,mdss-pan-physical-width-dimension = <68>;////68.04
		qcom,mdss-pan-physical-height-dimension = <144>;/*143.64 from wuhan 1208*/
		qcom,suspend-ulps-enabled;

		// TE configure
		qcom,mdss-tear-check-frame-rate = <6000>;
		qcom,mdss-tear-check-sync-cfg-height = <1918>;/**/
		qcom,mdss-tear-check-start-pos = <1823>;/*1823*/
		qcom,mdss-tear-check-rd-ptr-trigger-intr = <1822>;/*1822*/

		//ESD  read register check
		/*qcom,esd-check-enabled;*/
		qcom,mdss-dsi-panel-status-command = [06 01 00 01 05 00 02 0A 08];
		/*06 01 00 01 05 00 02 B4 08];*/
		qcom,mdss-dsi-panel-status-command-state = "dsi_lp_mode";
		qcom,mdss-dsi-panel-status-check-mode = "reg_read";
		qcom,mdss-dsi-panel-status-value = <0x1c>;/*,<0x00>;*/
		qcom,mdss-dsi-panel-status-read-length = <1 >;/* <1 1>;*/
		qcom,mdss-dsi-panel-max-error-count = <10>;

	};
};

/* Copyright (c) 2013, The Linux Foundation. All rights reserved.
 *
 * This program is free software; you can redistribute it and/or modify
 * it under the terms of the GNU General Public License version 2 and
 * only version 2 as published by the Free Software Foundation.
 *
 * This program is distributed in the hope that it will be useful,
 * but WITHOUT ANY WARRANTY; without even the implied warranty of
 * MERCHANTABILITY or FITNESS FOR A PARTICULAR PURPOSE.  See the
 * GNU General Public License for more details.
 */

/*---------------------------------------------------------------------------
 * This file is autogenerated file using gcdb parser. Please do not edit it.
 * Update input XML file to add a new entry or update variable in this file
 * VERSION = "1.0"
 *---------------------------------------------------------------------------*/
&mdss_mdp {
	dsi_pd1728_sofego1_1080_cmd: qcom,mdss_dsi_pd1728_sofego1_1080p_cmd {
		qcom,mdss-dsi-panel-name = "mdss_dsi_pd1728_sofego1_1080p_cmd panel";
		qcom,mdss-dsi-panel-controller = <&mdss_dsi0>;
		qcom,mdss-dsi-panel-type = "dsi_cmd_mode";
		qcom,mdss-dsi-project-name = "pd1728";
		qcom,mdss-panel-sre;
		qcom,mdss-dsi-panel-destination = "display_1";
		qcom,mdss-dsi-panel-framerate = <60>;
		//qcom,mdss-dsi-panel-clk-mipi-max = <996605504>; //type:966605504, max:
		qcom,mdss-dsi-panel-clockrate = <1156000000>;
		//qcom,mdss-mdp-transfer-time-us = <13800>;
		qcom,mdss-dsi-virtual-channel-id = <0>;
		qcom,mdss-dsi-stream = <0>;
		qcom,mdss-dsi-panel-id = <0x20>;
		qcom,mdss-dsi-panel-width = <1080>;
		qcom,mdss-dsi-panel-height = <2280>;
		qcom,mdss-dsi-h-front-porch = <100>;
		qcom,mdss-dsi-h-back-porch = <120>;
		qcom,mdss-dsi-h-pulse-width = <16>;
		qcom,mdss-dsi-h-sync-skew = <0>;
		qcom,mdss-dsi-v-back-porch = <82>;
		qcom,mdss-dsi-v-front-porch = <74>;
		qcom,mdss-dsi-v-pulse-width = <4>;
		qcom,mdss-dsi-h-left-border = <0>;
		qcom,mdss-dsi-h-right-border = <0>;
		qcom,mdss-dsi-v-top-border = <0>;
		qcom,mdss-dsi-v-bottom-border = <0>;
		qcom,mdss-dsi-bpp = <24>;
		qcom,mdss-dsi-underflow-color = <0x00>;
		qcom,mdss-dsi-border-color = <0>;
		//qcom,mdss-dsi-panel-orientation = "180";
		qcom,mdss-dsi-on-command = [
					// Sleep Out
					05 01 00 00 05 00 01 11
					39 01 00 00 00 00 03 F0 5A 5A
					39 01 00 00 00 00 02 B0 1E
					39 01 00 00 14 00 06 B5 00 00 00 00 00
					39 01 00 00 00 00 03 F0 A5 A5
					// Common Setting
					39 01 00 00 00 00 02 35 00
					39 01 00 00 00 00 03 F0 5A 5A
					39 01 00 00 00 00 0A EF 56 34 45 45 14 05 15 31 45
					39 01 00 00 00 00 02 BB 0D
					39 01 00 00 00 00 03 F0 A5 A5
					// Brightness Setting
					39 01 00 00 00 00 03 F0 5A 5A
					39 01 00 00 00 00 02 B0 05
					39 01 00 00 00 00 02 B1 01
					39 01 00 00 00 00 03 F0 A5 A5
					/* ACL Setting*/
					39 01 00 00 00 00 03 F0 5A 5A
					39 01 00 00 00 00 02 B0 0E
					39 01 00 00 00 00 02 B4 48
					39 01 00 00 00 00 03 F0 A5 A5
					//seed
					39 01 00 00 00 00 03 F0 5A 5A
					39 01 00 00 00 00 03 BC 01 12
					39 01 00 00 00 00 02 B0 02
					39 01 00 00 00 00 40 BC B6 0B 04 39 CB 12 06 06 B4 44 E4 CA CA 11 C2 E9 E3 18 F7 F5 FB B6 0B 04 39 CB 12 06 06 B4 44 E4 CA CA 11 C2 E9 E3 18 FF F0 DB FF 00 00 1C FF 01 01 13 FF 21 FF EA FF 12 F2 FF F8 00 FF FF FF
					39 01 00 00 00 00 02 B0 42
					39 01 00 00 00 00 02 BC 03
					39 01 00 00 00 00 02 B0 4B
					39 01 00 00 00 00 02 BC 4F
					39 01 00 00 00 00 03 F0 A5 A5
					//seed off
					/*
					//Turn off AVC Begin
					39 01 00 00 00 00 03 F0 5A 5A
					39 01 00 00 00 00 03 F1 5A 5A
					39 01 00 00 00 00 02 B0 04
					39 01 00 00 00 00 02 F4 0A
					39 01 00 00 00 00 03 F1 A5 A5
					39 01 00 00 00 00 03 F0 A5 A5
					//Turn off AVC End
					*/
					39 01 00 00 65 00 02 53 20
					39 01 00 00 00 00 02 55 00
					//39 01 00 00 00 00 03 51 03 FF
					// Display On
					05 01 00 00 00 00 01 29
					 ];
		// samsung OLED HBM mode
		qcom,mdss-oled-hbm-on-command-level1 =
		[
			39 01 00 00 00 00 03 F0 5A 5A
			39 01 00 00 00 00 04 B1 10 10 D9//520nit
			39 01 00 00 00 00 02 B0 05
			39 01 00 00 00 00 02 B1 28
			39 01 00 00 00 00 02 53 E8  //HBM on
			39 01 00 00 00 00 02 F7 03
			39 01 00 00 00 00 03 F0 A5 A5
		];

		qcom,mdss-oled-hbm-on-command-level2 =
		[
			39 01 00 00 00 00 03 F0 5A 5A
			39 01 00 00 00 00 04 B1 00 10 10//600nit
			39 01 00 00 00 00 02 B0 05
			39 01 00 00 00 00 02 B1 28
			39 01 00 00 00 00 02 53 E8  //HBM on
			39 01 00 00 00 00 02 F7 03
			39 01 00 00 00 00 03 F0 A5 A5
		];

		qcom,mdss-oled-hbm-off-command =
		[
			39 01 00 00 00 00 03 F0 5A 5A
			39 01 00 00 00 00 02 53 28 //HBM off
			39 01 00 00 00 00 03 F0 A5 A5
		];

		qcom,mdss-oled-hbm-on-command-ud-fingerprint =
		[
			39 00 00 00 00 00 03 51 03 FF
			39 00 00 00 00 00 03 F0 5A 5A
			39 00 00 00 00 00 04 B1 00 10 10//600nit
			39 00 00 00 00 00 02 53 E0  //HBM on
			39 00 00 00 00 00 02 F7 03
			39 01 00 00 00 00 03 F0 A5 A5
		];

		qcom,mdss-oled-hbm-off-command-ud-fingerprint =
		[
			39 00 00 00 00 00 03 F0 5A 5A
			// 00 00 00 00 00 03 B8 D0 52
			39 00 00 00 00 00 02 53 20 //HBM off
			39 01 00 00 00 00 03 F0 A5 A5
		];

		/*qcom,mdss-oled-ps-off-command =
		[
			39 00 00 00 00 00 03 F0 5A 5A
			39 00 00 00 00 00 03 B8 D0 5F
			39 01 00 00 00 00 03 F0 A5 A5
		];*/

		/*qcom,mdss-oled-ps-on-command =
		[
			39 00 00 00 00 00 03 F0 5A 5A
			39 00 00 00 00 00 03 B8 D0 52
			39 01 00 00 00 00 03 F0 A5 A5
		];*/

		qcom,mdss-oled-delay-on-command =
		[
			39 00 00 00 00 00 03 F0 5A 5A
			//39 00 00 00 00 00 03 B8 D0 52
			39 00 00 00 00 00 02 B0 02
			39 00 00 00 00 00 02 B5 00
			39 01 00 00 00 00 03 F0 A5 A5
		];

		qcom,mdss-oled-delay-off-command =
		[
			39 00 00 00 00 00 03 F0 5A 5A
			39 00 00 00 00 00 02 B0 02
			39 00 00 00 00 00 02 B5 80
			39 00 00 00 00 00 02 53 20
			39 01 00 00 00 00 03 F0 A5 A5
		];

		qcom,mdss-oled-acl-on-command-level1 =
		[
			39 01 00 00 00 00 03 F0 5A 5A
			39 01 00 00 00 00 02 55 01
			39 01 00 00 00 00 03 F0 A5 A5
		];
		qcom,mdss-oled-acl-on-command-level2 =
		[
			39 01 00 00 00 00 03 F0 5A 5A
			39 01 00 00 00 00 02 55 02
			39 01 00 00 00 00 03 F0 A5 A5
		];
		qcom,mdss-oled-acl-on-command-level3 =
		[
			39 01 00 00 00 00 03 F0 5A 5A
			39 01 00 00 00 00 02 55 03
			39 01 00 00 00 00 03 F0 A5 A5
		];
		qcom,mdss-oled-acl-off-command =
		[
			39 01 00 00 00 00 03 F0 5A 5A
			39 01 00 00 00 00 02 55 00
			39 01 00 00 00 00 03 F0 A5 A5
		];
		qcom,mdss-oled-dimming-speed =
		[
			39 00 00 00 00 00 03 F0 5A 5A
			39 00 00 00 00 00 02 B0 05
			39 00 00 00 00 00 02 B1 28
			39 00 00 00 00 00 03 F0 A5 A5
			39 01 00 00 00 00 02 53 28
		];
		qcom,mdss-oled-dimming-speed-off =
		[
			39 00 00 00 00 00 03 F0 5A 5A
			39 00 00 00 00 00 02 53 20
			39 01 00 00 00 00 03 F0 A5 A5
		];
		// samsung OLED ALPM mode, defaut mode  HLPM high brightness
		qcom,mdss-oled-alpm-on-command =
		[
			39 01 00 00 11 00 02 28 00
			39 01 00 00 00 00 03 F0 5A 5A
			39 01 00 00 00 00 02 B0 0F
			39 01 00 00 00 00 02 F4 50
			39 01 00 00 00 00 02 53 02
			39 01 00 00 00 00 02 BB 0D
			39 01 00 00 10 00 03 F0 A5 A5
			39 01 00 00 00 00 02 29 00
		];

		qcom,mdss-oled-alpm-hbirghtness-on-command =
		[
			39 01 00 00 00 00 03 F0 5A 5A
			39 01 00 00 00 00 02 B0 0F
			39 01 00 00 00 00 02 F4 50
			39 01 00 00 00 00 02 53 02
			39 01 00 00 00 00 02 BB 0F
			39 01 00 00 10 00 03 F0 A5 A5
			39 01 00 00 00 00 02 29 00
		];

		qcom,mdss-oled-alpm-lbirghtness-on-command =
		[
			39 01 00 00 00 00 03 F0 5A 5A
			39 01 00 00 00 00 02 B0 0F
			39 01 00 00 00 00 02 F4 50
			39 01 00 00 00 00 02 53 03
			39 01 00 00 00 00 02 BB 0F
			39 01 00 00 10 00 03 F0 A5 A5
			39 01 00 00 00 00 02 29 00
		];

		qcom,mdss-oled-hlpm-hbirghtness-on-command =
		[
			39 01 00 00 00 00 03 F0 5A 5A
			39 01 00 00 00 00 02 B0 0F
			39 01 00 00 00 00 02 F4 50
			39 01 00 00 00 00 02 53 02
			39 01 00 00 00 00 02 BB 0D
			39 01 00 00 10 00 03 F0 A5 A5
			39 01 00 00 00 00 02 29 00
		];

		qcom,mdss-oled-hlpm-lbirghtness-on-command =
		[
			39 01 00 00 00 00 03 F0 5A 5A
			39 01 00 00 00 00 02 B0 0F
			39 01 00 00 00 00 02 F4 50
			39 01 00 00 00 00 02 53 03
			39 01 00 00 00 00 02 BB 0D
			39 01 00 00 10 00 03 F0 A5 A5
			39 01 00 00 00 00 02 29 00
		];

		qcom,mdss-oled-alpm-off-command =
		[
			05 00 00 00 20 00 02 28 00
			39 00 00 00 00 00 03 F0 5A 5A
			39 00 00 00 00 00 02 53 20
			39 00 00 00 10 00 03 F0 A5 A5
			39 01 00 00 00 00 02 29 00
		];

		/*level1 raise 10nit brightness at 0 degree Celsius */
		qcom,mdss-brightness-compensate-level1 =
		[
			39 01 00 00 00 00 03 F0 5A 5A
			39 01 00 00 00 00 02 B0 0C
			39 01 00 00 00 00 07 B5 80 00 37 9C F2 12
			39 01 00 00 00 00 03 B5 80 CD
			39 01 00 00 00 00 03 F0 A5 A5
		];
		/*level2 raise 20nit brightness at -5 degree Celsius */
		qcom,mdss-brightness-compensate-level2 =
		[
			39 01 00 00 00 00 03 F0 5A 5A
			39 01 00 00 00 00 02 B0 0C
			39 01 00 00 00 00 07 B5 80 00 37 9C F2 12
			39 01 00 00 00 00 03 B5 85 CD
			39 01 00 00 00 00 03 F0 A5 A5
		];
		/*level3 raise 30nit brightness at -10 degree Celsius */
		qcom,mdss-brightness-compensate-level3 =
		[
			39 01 00 00 00 00 03 F0 5A 5A
			39 01 00 00 00 00 02 B0 0C
			39 01 00 00 00 00 07 B5 80 00 37 9C F2 12
			39 01 00 00 00 00 03 B5 8A CD
			39 01 00 00 00 00 03 F0 A5 A5
		];
		/*level4 raise 40nit brightness at -15 degree Celsius */
		qcom,mdss-brightness-compensate-level4 =
		[
			39 01 00 00 00 00 03 F0 5A 5A
			39 01 00 00 00 00 02 B0 0C
			39 01 00 00 00 00 07 B5 80 00 37 9C F2 12
			39 01 00 00 00 00 03 B5 8F CD
			39 01 00 00 00 00 03 F0 A5 A5
		];
		/*level5 raise 50nit brightness at -20 degree Celsius */
		qcom,mdss-brightness-compensate-level5 =
		[
			39 01 00 00 00 00 03 F0 5A 5A
			39 01 00 00 00 00 02 B0 0C
			39 01 00 00 00 00 07 B5 80 00 37 9C F2 12
			39 01 00 00 00 00 03 B5 94 CD
			39 01 00 00 00 00 03 F0 A5 A5
		];
		/*close brightness compensate*/
		qcom,mdss-brightness-compensate-off =
		[
			39 01 00 00 00 00 03 F0 5A 5A
			39 01 00 00 00 00 02 B0 01
			39 01 00 00 00 00 02 B5 C9
			39 01 00 00 00 00 03 F0 A5 A5
		];
		qcom,mdss-alpm-command-state = "dsi_lp_mode";

		qcom,mdss-dsi-off-command = [
			39 01 00 00 11 00 02 28 00
			39 01 00 00 00 00 03 F0 5A 5A
			39 01 00 00 00 00 02 B0 0C
			39 01 00 00 00 00 02 CB FF
			39 01 00 00 00 00 02 B0 1A
			39 01 00 00 00 00 02 CB FB
			39 01 00 00 00 00 02 F7 03
			39 01 00 00 11 00 03 F0 A5 A5
			39 01 00 00 97 00 02 10 00
		];

		qcom,mdss-dsi-on-command-state = "dsi_lp_mode";
		qcom,mdss-dsi-off-command-state = "dsi_hs_mode";
		qcom,mdss-dsi-h-sync-pulse = <0>;
		qcom,mdss-dsi-traffic-mode = <1>;
		qcom,mdss-dsi-bllp-eof-power-mode;
		qcom,mdss-dsi-lane-0-state;
		qcom,mdss-dsi-lane-1-state;
		qcom,mdss-dsi-lane-2-state;
		qcom,mdss-dsi-lane-3-state;
		qcom,mdss-dsi-lp11-init;
		qcom,mdss-dsi-init-delay-us = <2000>;
		qcom,mdss-dsi-te-pin-select = <1>;
		qcom,mdss-dsi-wr-mem-start = <0x2c>;
		qcom,mdss-dsi-wr-mem-continue = <0x3c>;
		qcom,mdss-dsi-te-dcs-command = <1>;
		qcom,mdss-dsi-te-check-enable;
		qcom,mdss-dsi-te-using-te-pin;

		//qcom,mdss-dsi-panel-timings = [29 40 2C 01 76 7A 30 44 34 03 04 00];
		qcom,mdss-dsi-t-clk-post = <0x0F>;
		qcom,mdss-dsi-t-clk-pre = <0x3A>;
	
		qcom,mdss-dsi-bl-min-level = <1>;
		qcom,mdss-dsi-bl-max-level = <1023>;
		qcom,mdss-dsi-dma-trigger = "trigger_sw";
		qcom,mdss-dsi-mdp-trigger = "none";
		qcom,mdss-dsi-bl-pmic-control-type = "bl_ctrl_dcs";
		qcom,mdss-dsi-reset-sequence = <1 5>, <0 5>, <1 5>;
		qcom,mdss-pan-physical-width-dimension = <68>;
		qcom,mdss-pan-physical-height-dimension = <144>;
		
		// TE configure
		qcom,mdss-tear-check-frame-rate = <6000>;
		qcom,mdss-tear-check-sync-cfg-height = <5000>;
		//qcom,mdss-tear-check-start-pos = <1823>;
		//qcom,mdss-tear-check-rd-ptr-trigger-intr = <1822>;
		/*
		//ESD  read register check
		qcom,esd-check-enabled;
		qcom,mdss-dsi-panel-status-command = [06 01 00 01 05 00 02 0A 08];
		qcom,mdss-dsi-panel-status-command-state = "dsi_lp_mode";
		qcom,mdss-dsi-panel-status-check-mode = "reg_read";
		qcom,mdss-dsi-panel-status-value = <0x9e>;
		qcom,mdss-dsi-panel-status-read-length = <1>;
		qcom,mdss-dsi-panel-max-error-count = <10>;
		*/
		// ESD err flag interrup detect
		//qcom,esd-check-enabled;
		//qcom,mdss-dsi-panel-status-check-mode = "irq_triger";

	};
};

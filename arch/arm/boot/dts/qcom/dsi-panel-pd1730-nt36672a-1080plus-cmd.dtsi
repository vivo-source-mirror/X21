/* Copyright (c) 2013, The Linux Foundation. All rights reserved.
 *
 * This program is free software; you can redistribute it and/or modify
 * it under the terms of the GNU General Public License version 2 and
 * only version 2 as published by the Free Software Foundation.
 *
 * This program is distributed in the hope that it will be useful,
 * but WITHOUT ANY WARRANTY; without even the implied warranty of
 * MERCHANTABILITY or FITNESS FOR A PARTICULAR PURPOSE.  See the
 * GNU General Public License for more details.
 */

/*---------------------------------------------------------------------------
 * This file is autogenerated file using gcdb parser. Please do not edit it.
 * Update input XML file to add a new entry or update variable in this file
 * VERSION = "1.0"
 *---------------------------------------------------------------------------*/
&mdss_mdp {
	dsi_pd1730_nt36672a_1080plus_cmd: qcom,mdss_dsi_pd1730_nt36672a_1080plus_cmd {
		qcom,mdss-dsi-panel-name = "mdss_dsi_pd1730_nt36672a_1080plus_cmd panel";
		qcom,mdss-dsi-panel-controller = <&mdss_dsi0>;
		qcom,mdss-dsi-panel-type = "dsi_video_mode";
		qcom,mdss-dsi-project-name = "pd1730";
		qcom,mdss-dsi-panel-destination = "display_1";
		qcom,mdss-dsi-panel-framerate = <60>;
		//qcom,mdss-dsi-panel-clk-mipi-max = <996605504>; //type:966605504, max:
		//qcom,mdss-dsi-panel-clockrate =<655000000>;
		qcom,mdss-dsi-virtual-channel-id = <0>;
		qcom,mdss-dsi-stream = <0>;
		qcom,mdss-dsi-panel-id = <0x32>;
		qcom,mdss-dsi-panel-width = <1080>;
		qcom,mdss-dsi-panel-height = <2280>;

		qcom,mdss-dsi-h-front-porch = <20>;
		qcom,mdss-dsi-h-back-porch = <291>;
		qcom,mdss-dsi-h-pulse-width = <4>;
		qcom,mdss-dsi-h-sync-skew = <0>;
		qcom,mdss-dsi-v-front-porch = <12>;/*16*/
		qcom,mdss-dsi-v-back-porch = <12>;/*25*/
		qcom,mdss-dsi-v-pulse-width = <2>;


		qcom,mdss-dsi-h-left-border = <0>;
		qcom,mdss-dsi-h-right-border = <0>;
		qcom,mdss-dsi-v-top-border = <0>;
		qcom,mdss-dsi-v-bottom-border = <0>;
		qcom,mdss-dsi-bpp = <24>;
		qcom,mdss-dsi-underflow-color = <0xFF>;
		qcom,mdss-dsi-border-color = <0>;
		qcom,mdss-dsi-pixel-packing = "tight";
		qcom,mdss-dsi-on-command = [
/*code server*/


/*10ver initial start*/
//29 01 00 00 00 00 02 FF 10
//29 01 00 00 00 00 02 B0 01
29 01 00 00 00 00 02 FF 20
29 01 00 00 00 00 02 FB 01
29 01 00 00 00 00 02 00 01
29 01 00 00 00 00 02 01 55
29 01 00 00 00 00 02 02 55
29 01 00 00 00 00 02 04 00
29 01 00 00 00 00 02 05 5F
29 01 00 00 00 00 02 06 99
29 01 00 00 00 00 02 07 A3
29 01 00 00 00 00 02 0E AB
29 01 00 00 00 00 02 0F AE
29 01 00 00 00 00 02 30 10
29 01 00 00 00 00 02 61 81
29 01 00 00 00 00 02 62 BC
29 01 00 00 00 00 02 69 99
29 01 00 00 00 00 02 6D 44
29 01 00 00 00 00 02 FF 24
29 01 00 00 00 00 02 FB 01
29 01 00 00 00 00 02 00 1C
29 01 00 00 00 00 02 01 1C
29 01 00 00 00 00 02 02 1C
29 01 00 00 00 00 02 03 1C
29 01 00 00 00 00 02 04 1C
29 01 00 00 00 00 02 05 1C
29 01 00 00 00 00 02 06 1C
29 01 00 00 00 00 02 07 1C
29 01 00 00 00 00 02 08 1C
29 01 00 00 00 00 02 09 00
29 01 00 00 00 00 02 0A 1F
29 01 00 00 00 00 02 0B 0E
29 01 00 00 00 00 02 0C 0E
29 01 00 00 00 00 02 0D 14
29 01 00 00 00 00 02 0E 12
29 01 00 00 00 00 02 0F 10
29 01 00 00 00 00 02 10 03
29 01 00 00 00 00 02 11 04
29 01 00 00 00 00 02 12 A5
29 01 00 00 00 00 02 13 9E
29 01 00 00 00 00 02 14 9E
29 01 00 00 00 00 02 15 09
29 01 00 00 00 00 02 16 0A
29 01 00 00 00 00 02 17 1C
29 01 00 00 00 00 02 18 1C
29 01 00 00 00 00 02 19 1C
29 01 00 00 00 00 02 1A 1C
29 01 00 00 00 00 02 1B 1C
29 01 00 00 00 00 02 1C 1C
29 01 00 00 00 00 02 1D 1C
29 01 00 00 00 00 02 1E 1C
29 01 00 00 00 00 02 1F 00
29 01 00 00 00 00 02 20 0F
29 01 00 00 00 00 02 21 1F
29 01 00 00 00 00 02 22 0E
29 01 00 00 00 00 02 23 0E
29 01 00 00 00 00 02 24 1C
29 01 00 00 00 00 02 25 1C
29 01 00 00 00 00 02 26 1C
29 01 00 00 00 00 02 27 03
29 01 00 00 00 00 02 28 04
29 01 00 00 00 00 02 29 A5
29 01 00 00 00 00 02 2A 9E
29 01 00 00 00 00 02 2B 9E
29 01 00 00 00 00 02 2D 09
29 01 00 00 00 00 02 2F 0A
29 01 00 00 00 00 02 31 02
29 01 00 00 00 00 02 32 03
29 01 00 00 00 00 02 33 0A
29 01 00 00 00 00 02 35 49
29 01 00 00 00 00 02 37 01
29 01 00 00 00 00 02 38 6F
29 01 00 00 00 00 02 39 6F
29 01 00 00 00 00 02 3F 70
29 01 00 00 00 00 02 41 02
29 01 00 00 00 00 02 42 03
29 01 00 00 00 00 02 4C 01
29 01 00 00 00 00 02 4D 01
29 01 00 00 00 00 02 61 E8
29 01 00 00 00 00 02 72 00
29 01 00 00 00 00 02 73 00
29 01 00 00 00 00 02 74 00
29 01 00 00 00 00 02 75 00
29 01 00 00 00 00 02 79 00
29 01 00 00 00 00 02 7A 08
29 01 00 00 00 00 02 7B 1E
29 01 00 00 00 00 02 7D 04
29 01 00 00 00 00 02 80 42
29 01 00 00 00 00 02 82 13
29 01 00 00 00 00 02 83 22
29 01 00 00 00 00 02 84 31
29 01 00 00 00 00 02 85 00
29 01 00 00 00 00 02 86 00
29 01 00 00 00 00 02 87 00
29 01 00 00 00 00 02 88 13
29 01 00 00 00 00 02 89 22
29 01 00 00 00 00 02 8A 31
29 01 00 00 00 00 02 8B 00
29 01 00 00 00 00 02 8C 00
29 01 00 00 00 00 02 8D 00
29 01 00 00 00 00 02 8E F4
29 01 00 00 00 00 02 8F 01
29 01 00 00 00 00 02 90 80
29 01 00 00 00 00 02 92 72
29 01 00 00 00 00 02 93 10
29 01 00 00 00 00 02 94 10
29 01 00 00 00 00 02 B3 02
29 01 00 00 00 00 02 B4 00
29 01 00 00 00 00 02 B5 04
29 01 00 00 00 00 02 C2 80
29 01 00 00 00 00 02 C4 A9
29 01 00 00 00 00 02 C9 C0
29 01 00 00 00 00 02 DC 29
29 01 00 00 00 00 02 DD 02
29 01 00 00 00 00 02 DE 00
29 01 00 00 00 00 02 DF 01
29 01 00 00 00 00 02 E0 01
29 01 00 00 00 00 02 EB 08
29 01 00 00 00 00 02 FF 25
29 01 00 00 00 00 02 FB 01
//29 01 00 00 00 00 02 18 96
29 01 00 00 00 00 02 21 1F
29 01 00 00 00 00 02 22 1E
29 01 00 00 00 00 02 24 75
29 01 00 00 00 00 02 25 6B
29 01 00 00 00 00 02 2F 00
29 01 00 00 00 00 02 30 2F
29 01 00 00 00 00 02 31 2F
29 01 00 00 00 00 02 38 2F
29 01 00 00 00 00 02 40 70
29 01 00 00 00 00 02 41 70
29 01 00 00 00 00 02 4C 70
29 01 00 00 00 00 02 58 09
29 01 00 00 00 00 02 59 28
29 01 00 00 00 00 02 5C 05
29 01 00 00 00 00 02 5F 2A
29 01 00 00 00 00 02 63 87
29 01 00 00 00 00 02 66 D8
29 01 00 00 00 00 02 67 02
29 01 00 00 00 00 02 68 58
29 01 00 00 00 00 02 69 20
29 01 00 00 00 00 02 6B 00
29 01 00 00 00 00 02 71 2D
29 01 00 00 00 00 02 76 04
29 01 00 00 00 00 02 77 72
29 01 00 00 00 00 02 7F 00
29 01 00 00 00 00 02 81 00
29 01 00 00 00 00 02 84 1D
29 01 00 00 00 00 02 85 75
29 01 00 00 00 00 02 86 75
29 01 00 00 00 00 02 89 00
29 01 00 00 00 00 02 8D 00
29 01 00 00 00 00 02 8E 00
29 01 00 00 00 00 02 8F 04
29 01 00 00 00 00 02 C1 B2
29 01 00 00 00 00 02 C2 D9
29 01 00 00 00 00 02 C3 12
29 01 00 00 00 00 02 CA 02
29 01 00 00 00 00 02 CB 82
29 01 00 00 00 00 02 D9 48
29 01 00 00 00 00 02 DB 32
29 01 00 00 00 00 02 FF 26
29 01 00 00 00 00 02 FB 01
29 01 00 00 00 00 02 06 FF
29 01 00 00 00 00 02 0C 13
29 01 00 00 00 00 02 12 71
29 01 00 00 00 00 02 15 80
29 01 00 00 00 00 02 19 0C
29 01 00 00 00 00 02 1A BF
29 01 00 00 00 00 02 1C AF
29 01 00 00 00 00 02 1D 0C
29 01 00 00 00 00 02 1E 42
29 01 00 00 00 00 02 36 FA
29 01 00 00 00 00 02 98 F1
29 01 00 00 00 00 02 A9 16
29 01 00 00 00 00 02 AE 00
29 01 00 00 00 00 02 AF 04
29 01 00 00 00 00 02 B1 08
29 01 00 00 00 00 02 B2 1E
29 01 00 00 00 00 02 B4 72
29 01 00 00 00 00 02 BC 04
29 01 00 00 00 00 02 BE 08
29 01 00 00 00 00 02 BF 1E
29 01 00 00 00 00 02 C1 72
29 01 00 00 00 00 02 FF 27
29 01 00 00 00 00 02 FB 01
29 01 00 00 00 00 02 13 00
29 01 00 00 00 00 02 1E 25
29 01 00 00 00 00 02 B3 01
29 01 00 00 00 00 02 B5 7A
29 01 00 00 00 00 02 D9 18
29 01 00 00 00 00 02 FF F0
29 01 00 00 00 00 02 FB 01
29 01 00 00 00 00 02 A2 00
29 01 00 00 00 00 02 FF 10

29 01 00 00 00 00 02 FF 23
29 01 00 00 00 00 02 FB 01
29 01 00 00 00 00 02 08 04

29 01 00 00 00 00 02 FF 10
29 01 00 00 00 00 02 FB 01

39 01 00 00 00 00 02 51 FF
39 01 00 00 00 00 02 53 2C
39 01 00 00 00 00 02 55 00

39 01 00 00 00 00 02 FF 23/*cabc 2 mode start*/
39 01 00 00 00 00 02 FB 01
39 01 00 00 00 00 02 11 01
39 01 00 00 00 00 02 12 7E
39 01 00 00 00 00 02 15 6E
39 01 00 00 00 00 02 16 0B
39 01 00 00 00 00 02 45 FF
39 01 00 00 00 00 02 46 F6
39 01 00 00 00 00 02 47 ED
39 01 00 00 00 00 02 48 E6
39 01 00 00 00 00 02 49 DF
39 01 00 00 00 00 02 4A D8
39 01 00 00 00 00 02 4B D3
39 01 00 00 00 00 02 4C CE
39 01 00 00 00 00 02 4D C9
39 01 00 00 00 00 02 4E C4
39 01 00 00 00 00 02 4F C1
39 01 00 00 00 00 02 50 BE
39 01 00 00 00 00 02 51 BB
39 01 00 00 00 00 02 52 B8
39 01 00 00 00 00 02 53 B6
39 01 00 00 00 00 02 54 B5
39 01 00 00 00 00 02 58 FF
39 01 00 00 00 00 02 59 F6
39 01 00 00 00 00 02 5A ED
39 01 00 00 00 00 02 5B E6
39 01 00 00 00 00 02 5C DF
39 01 00 00 00 00 02 5D D8
39 01 00 00 00 00 02 5E D3
39 01 00 00 00 00 02 5F CE
39 01 00 00 00 00 02 60 C9
39 01 00 00 00 00 02 61 C4
39 01 00 00 00 00 02 62 C1
39 01 00 00 00 00 02 63 BE
39 01 00 00 00 00 02 64 BB
39 01 00 00 00 00 02 65 B8
39 01 00 00 00 00 02 66 B6
39 01 00 00 00 00 02 67 B5

39 01 00 00 00 00 02 FF 10
39 01 00 00 00 00 02 FB 01
39 01 00 00 00 00 02 51 FF
39 01 00 00 00 00 02 53 24
39 01 00 00 00 00 02 55 02/*cabc 2 mode end*/

29 01 00 00 6E 00 02 11 00/*at least 100ms from 0104spec*/
29 01 00 00 14 00 02 29 00
];

		

		qcom,mdss-dsi-off-command = [

					39 01 00 00 14 00 02 28 00
					39 01 00 00 50 00 02 10 00/*reset down 70ms later than 0x10*/
					/*39 01 00 00 00 00 02 04 5A
					39 01 00 00 00 00 02 05 5A*/
					];
		qcom,mdss-dsi-on-command-state = "dsi_lp_mode";
		qcom,mdss-dsi-off-command-state = "dsi_lp_mode";
		qcom,mdss-dsi-h-sync-pulse = <1>;
		/*qcom,mdss-dsi-traffic-mode = "non_burst_sync_event";*/
		qcom,mdss-dsi-traffic-mode = "non_burst_sync_pulse";
		qcom,mdss-dsi-bllp-eof-power-mode;
		qcom,mdss-dsi-bllp-power-mode;
		/*qcom,mdss-dsi-hbp-power-mode;*/
		qcom,mdss-dsi-tx-eot-append;
		qcom,mdss-dsi-lane-0-state;
		qcom,mdss-dsi-lane-1-state;
		qcom,mdss-dsi-lane-2-state;
		qcom,mdss-dsi-lane-3-state;
		qcom,mdss-dsi-lp11-init;
		/*qcom,mdss-dsi-init-delay-us = <15000>;*/
		//qcom,mdss-dsi-panel-timings = [88 1C 12 00 42 44 18 20 16 03 04 00];

		qcom,mdss-dsi-panel-timings-phy-v2 = [
		10 21 0A 0C 07 03 04 a0
		10 21 0A 0C 07 03 04 a0
		10 21 0A 0C 07 03 04 a0
		10 21 0A 0C 07 03 04 a0
		10 23 0A 0C 07 03 04 a0];
		qcom,mdss-dsi-t-clk-post = <0x01>;
		qcom,mdss-dsi-t-clk-pre = <0x3B>;//0x1B

		qcom,mdss-dsi-bl-min-level = <1>;
		qcom,mdss-dsi-bl-max-level = <2047>;
		/*qcom,panel-supply-entries = <&dsi_panel_pwr_supply>;*/
		qcom,mdss-dsi-dma-trigger = "trigger_sw";
		qcom,mdss-dsi-mdp-trigger = "none";
		qcom,mdss-dsi-bl-pmic-control-type = "bl_i2c";
		qcom,mdss-dsi-reset-sequence = <1 5>, <0 5>, <1 15>;
		qcom,mdss-pan-physical-width-dimension = <68>;////68.04
		qcom,mdss-pan-physical-height-dimension = <144>;////143.64 from wuhan 1208
		qcom,suspend-ulps-enabled;

		//ESD  read register check
		//qcom,esd-check-enabled;
		qcom,mdss-dsi-panel-status-command = [06 01 00 01 05 00 02 0A 08];
		qcom,mdss-dsi-panel-status-command-state = "dsi_lp_mode";
		qcom,mdss-dsi-panel-status-check-mode = "reg_read";
		qcom,mdss-dsi-panel-status-value = <0x1c>;
		qcom,mdss-dsi-panel-status-read-length = <1>;
		qcom,mdss-dsi-panel-max-error-count = <10>;

	};
};
